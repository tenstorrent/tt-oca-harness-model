// SPDX-License-Identifier: Apache-2.0
// SPDX-FileCopyrightText: 2026 Tenstorrent USA, Inc.
/*
 * SPI Sanity Test for OCH SEP - Cadence xSPI Controller
 *
 * This test verifies the Cadence xSPI controller initialization at 25 MHz.
 * It programs the PHY timing parameters generated by the Cadence script
 * and waits for the controller to complete initialization with the SPI flash.
 *
 * The Cadence xSPI controller includes a DLL (Delay-Locked Loop) which enables
 * operation at higher frequencies compared to standard SPI controllers.
 *
 * Adapted from tt_sep/firmware/spi_sanity for the OCH SEP platform.
 *
 * PHY Register Settings (from cadence_flash_phy_reg_setting.pl):
 *   Input: clk_period=40ns, dqs_en=1, flash_setup=10.6, board_delay=2.3
 *   Output:
 *     dll_phy_ctrl            0x00000707
 *     phy_ctrl_reg            0x00004000
 *     phy_tsel_reg            0x00000000
 *     phy_dq_timing_reg       0x00000101
 *     phy_dqs_timing_reg      0x00000404
 *     phy_gate_lpbk_ctrl_reg  0x00200030
 *     phy_dll_master_ctrl_reg 0x003400e4
 *     phy_dll_slave_ctrl_reg  0x00003305
 *
 * Test Flow:
 *   1. Configure SPI mux (select Cadence, clear cs_force_high)
 *   2. Disable and reset SPI controller
 *   3. Program clock divider for 25 MHz (sys=100MHz, div=4)
 *   4. Set PHY timing parameters
 *   5. Configure discovery parameters (8-lane DDR)
 *   6. Enable controller and deassert reset
 *   7. Wait for init_comp status from Cadence controller
 *
 * System Clock: 100 MHz (testbench)
 *
 * Copyright 2025 Tenstorrent Inc.
 */

#include <stdint.h>
#include <stdio.h>
#include "och_sep_top_reg.h"
#include "och_sep_common.h"
#include "test_completion.h"
#include "sep_outbound_filter.h"

//==============================================================================
// SPI Mux Control Functions
//==============================================================================

/**
 * Configure SPI mux - select Cadence controller and release CS force
 *
 * The SPI mux has two important control bits:
 *   - spi_sel: 0 = Cadence xSPI, 1 = OpenTitan SPI Host
 *   - cs_force_high: 1 = force all CS# pins high (deasserted)
 *
 * The default value has cs_force_high=1 for safety during power-up.
 * This function clears cs_force_high to allow normal CS# operation.
 */
static void configure_spi_mux(void)
{
    OCH_SEP_SPI_MUX_CTRL_SPI_MUX_CTRL_reg_u spi_mux = {
        .val = OCH_SEP_SPI_MUX_CTRL_SPI_MUX_CTRL_REG_DEFAULT
    };

    // Select Cadence xSPI controller
    spi_mux.f.spi_sel = 0;

    // Clear cs_force_high to allow normal CS# operation
    // Default is 1 (force high for safety), must clear for SPI to work
    spi_mux.f.cs_force_high = 0;

    WRITE_REG(SEP_AXI_EXTENSION_OCH_SEP_SPI_MUX_CTRL_SPI_MUX_CTRL_REG_ADDR, spi_mux.val);

    printf("SPI mux configured: spi_sel=0 (Cadence), cs_force_high=0\n");
}

//==============================================================================
// SPI Controller Control Functions
//==============================================================================

/**
 * Reset SPI controller
 * @param reset 0 = assert reset, 1 = deassert reset
 */
static void reset_spi_controller(int reset)
{
    OCH_SEP_CDNS_SPI_CTRL_SPI_CTRL_reg_u spi_ctrl = {.val = OCH_SEP_CDNS_SPI_CTRL_SPI_CTRL_REG_DEFAULT};
    spi_ctrl.f.spi_reset_n_n0_scan = reset;
    spi_ctrl.f.spi_ctrl_reg_reset_n_n0_scan = reset;
    spi_ctrl.f.spi_phy_reg_reset_n_n0_scan = reset;
    spi_ctrl.f.spi_phy_reset_n_n0_scan = reset;
    spi_ctrl.f.spi_axi_reset_n_n0_scan = reset;
    spi_ctrl.f.spi_reg_reset_n_n0_scan = reset;
    spi_ctrl.f.spi_xspi_reg_reset_n_n0_scan = reset;
    spi_ctrl.f.spi_enable = reset;
    WRITE_REG(SEP_AXI_EXTENSION_OCH_SEP_CDNS_SPI_CTRL_SPI_CTRL_REG_ADDR, spi_ctrl.val);
}

/**
 * Enable/disable SPI controller pads
 * @param enable 0 = disable, 1 = enable
 */
static void enable_spi_controller(int enable)
{
    OCH_SEP_CDNS_SPI_CTRL_SPI_CTRL_reg_u spi_ctrl = {.val = OCH_SEP_CDNS_SPI_CTRL_SPI_CTRL_REG_DEFAULT};
    spi_ctrl.f.spi_enable = enable;
    WRITE_REG(SEP_AXI_EXTENSION_OCH_SEP_CDNS_SPI_CTRL_SPI_CTRL_REG_ADDR, spi_ctrl.val);
}

/**
 * Program SPI clock divider
 * @param target_freq Target SPI clock frequency in MHz
 * @param sys_freq System clock frequency in MHz
 */
static void program_spi_clk_div(uint32_t target_freq, uint32_t sys_freq)
{
    uint8_t divider = sys_freq / target_freq;
    OCH_SEP_CDNS_SPI_CTRL_SPI_CLK_DIV_CTRL_reg_u spi_clk_div_ctrl = {
        .val = OCH_SEP_CDNS_SPI_CTRL_SPI_CLK_DIV_CTRL_REG_DEFAULT
    };
    spi_clk_div_ctrl.f.clock_divider_value = divider;
    spi_clk_div_ctrl.f.clock_div_set = 1;
    spi_clk_div_ctrl.f.clock_dutycycle = 128;  // 50% duty cycle
    spi_clk_div_ctrl.f.clock_div_enable = 1;
    WRITE_REG(SEP_AXI_EXTENSION_OCH_SEP_CDNS_SPI_CTRL_SPI_CLK_DIV_CTRL_REG_ADDR, spi_clk_div_ctrl.val);
}

/**
 * Wait for Cadence xSPI controller initialization to complete
 * @return 0 on success, 1 on failure
 */
static int try_init_new(void)
{
    CTRL_CMD_STAT_CTRL_STATUS_reg_u spi_status;
    int timeout = 1000000;

    // Wait for init_comp bit
    do {
        spi_status.val = READ_REG(SEP_AXI_EXTENSION_CDNS_XSPI_CTRL_REG_CTRL_CMD_STAT_A_CTRL_STATUS_REG_ADDR);
        if (--timeout <= 0) {
            printf("ERROR: Timeout waiting for SPI init_comp\n");
            return 1;
        }
    } while (spi_status.f.init_comp == 0);

    // Check for initialization failure
    if (spi_status.f.init_fail == 1) {
        printf("ERROR: SPI initialization failed (init_fail=1)\n");
        return 1;
    }

    printf("  SPI init complete: status=0x%08x\n", spi_status.val);
    return 0;
}

//==============================================================================
// PHY Timing Parameter Functions (from Cadence DLL settings)
//==============================================================================

/**
 * Set PHY timing parameters for 25 MHz (40ns clock period)
 *
 * Generated by: /proj_soc/user_dev/hliao/xspi/xspi/cdn_ip6184_19e8_dll_phy/software/xspi/cadence_flash_phy_reg_setting.pl
 * Input parameters:
 *   dqs_en          1
 *   lpbk_en         0
 *   ext_lpbk_en     0
 *   clk_period      40
 *   flash_setup     10.6
 *   board_delay     2.3
 *   nand2_delay     70
 *   tdqsq           0.4
 *   tx_flash_setup  10
 *
 * Output register settings:
 *   dll_phy_ctrl            0x00000707
 *   phy_ctrl_reg            0x00004000
 *   phy_tsel_reg            0x00000000
 *   phy_dq_timing_reg       0x00000101
 *   phy_dqs_timing_reg      0x00000404
 *   phy_gate_lpbk_ctrl_reg  0x00200030
 *   phy_dll_master_ctrl_reg 0x003400e4  (modified from script output 0x001400e4)
 *   phy_dll_slave_ctrl_reg  0x00003305
 */
static void set_por_timing_parameter_lowspeed(void)
{
    // PHY DQS timing: 0x00000404
    OCH_SEP_CDNS_SPI_CTRL_INIT_PHY_DQS_TIMING_reg_u init_phy_dqs_timing = {
        .val = OCH_SEP_CDNS_SPI_CTRL_INIT_PHY_DQS_TIMING_REG_DEFAULT
    };
    init_phy_dqs_timing.f.phy_dqs_timing = 0x00000404;
    WRITE_REG(SEP_AXI_EXTENSION_OCH_SEP_CDNS_SPI_CTRL_INIT_PHY_DQS_TIMING_REG_ADDR, init_phy_dqs_timing.val);

    // PHY DQ timing: 0x00000101
    OCH_SEP_CDNS_SPI_CTRL_INIT_PHY_DQ_TIMING_reg_u init_phy_dq_timing = {
        .val = OCH_SEP_CDNS_SPI_CTRL_INIT_PHY_DQ_TIMING_REG_DEFAULT
    };
    init_phy_dq_timing.f.phy_dq_timing = 0x00000101;
    WRITE_REG(SEP_AXI_EXTENSION_OCH_SEP_CDNS_SPI_CTRL_INIT_PHY_DQ_TIMING_REG_ADDR, init_phy_dq_timing.val);

    // PHY DLL master control: 0x003400e4 (bit[21:20]=0x3 for DLL bypass)
    OCH_SEP_CDNS_SPI_CTRL_INIT_PHY_DLL_MASTER_CTRL_reg_u init_phy_dll_master = {
        .val = OCH_SEP_CDNS_SPI_CTRL_INIT_PHY_DLL_MASTER_CTRL_REG_DEFAULT
    };
    init_phy_dll_master.f.phy_dll_master_ctrl = 0x003400ff;
    WRITE_REG(SEP_AXI_EXTENSION_OCH_SEP_CDNS_SPI_CTRL_INIT_PHY_DLL_MASTER_CTRL_REG_ADDR, init_phy_dll_master.val);

    // PHY DLL slave control: 0x00003305
    OCH_SEP_CDNS_SPI_CTRL_INIT_PHY_DLL_SLAVE_CTRL_reg_u init_phy_dll_slave = {
        .val = OCH_SEP_CDNS_SPI_CTRL_INIT_PHY_DLL_SLAVE_CTRL_REG_DEFAULT
    };
    init_phy_dll_slave.f.phy_dll_slave_ctrl = 0x00003306;
    WRITE_REG(SEP_AXI_EXTENSION_OCH_SEP_CDNS_SPI_CTRL_INIT_PHY_DLL_SLAVE_CTRL_REG_ADDR, init_phy_dll_slave.val);

    // PHY gate loopback control: 0x00200030
    OCH_SEP_CDNS_SPI_CTRL_INIT_PHY_GATE_LPBK_CTRL_reg_u init_phy_gate_lpbk_ctrl = {
        .val = OCH_SEP_CDNS_SPI_CTRL_INIT_PHY_GATE_LPBK_CTRL_REG_DEFAULT
    };
    init_phy_gate_lpbk_ctrl.f.phy_gate_lpbk_ctrl = 0x00200030;
    WRITE_REG(SEP_AXI_EXTENSION_OCH_SEP_CDNS_SPI_CTRL_INIT_PHY_GATE_LPBK_CTRL_REG_ADDR, init_phy_gate_lpbk_ctrl.val);
}

/**
 * Set flash discovery parameters
 * @param num_dataline Number of data lines (8 for octal)
 * @param ddr 1 for DDR, 0 for SDR
 * @param full_discovery 1 for full discovery, 0 for partial
 */
static void set_discovery_param(int num_dataline, int ddr, int full_discovery)
{
    OCH_SEP_CDNS_SPI_CTRL_SPI_DISCOVERY_CTRL_reg_u discovery_ctrl = {
        .val = OCH_SEP_CDNS_SPI_CTRL_SPI_DISCOVERY_CTRL_REG_DEFAULT
    };
    if (full_discovery == 1) {
        discovery_ctrl.f.discovery_num_lines = 0;
        WRITE_REG(SEP_AXI_EXTENSION_OCH_SEP_CDNS_SPI_CTRL_SPI_DISCOVERY_CTRL_REG_ADDR, discovery_ctrl.val);
    } else {
        discovery_ctrl.f.discovery_num_lines = num_dataline;
        discovery_ctrl.f.discovery_cmd_type = ddr;
        WRITE_REG(SEP_AXI_EXTENSION_OCH_SEP_CDNS_SPI_CTRL_SPI_DISCOVERY_CTRL_REG_ADDR, discovery_ctrl.val);
    }
}

//==============================================================================
// Main Test
//==============================================================================

int main(void)
{
    // Initialize outbound filter to allow testpass mailbox access
    // sep_outbound_filter_init();

#ifdef USE_OT_SPI
    /* ==================================================================
     * OpenTitan SPI Sanity Test
     * Mirrors the Cadence sanity test: verify the OT SPI controller
     * can be initialized and used for basic SPI communication.
     *
     * Test Flow:
     *   1. Configure SPI mux for OpenTitan (spi_sel=1, cs_force_high=0)
     *   2. Enable SPIEN + OUTPUT_EN, configure CLKDIV=9
     *   3. Verify STATUS.READY=1
     *   4. Issue 1-byte TX command, wait for completion
     *   5. Verify no ERROR_STATUS set
     * ================================================================== */
    int pass = 1;
    SPI_CONTROLLER_STATUS_reg_u status;
    SPI_CONTROLLER_CTRL_reg_u ctrl;

    printf("\n========================================\n");
    printf("OCH SEP OpenTitan SPI Sanity Test\n");
    printf("========================================\n\n");

    /* Step 1: Configure SPI mux for OpenTitan */
    {
        OCH_SEP_SPI_MUX_CTRL_SPI_MUX_CTRL_reg_u spi_mux = {
            .val = OCH_SEP_SPI_MUX_CTRL_SPI_MUX_CTRL_REG_DEFAULT
        };
        spi_mux.f.spi_sel = 1;
        spi_mux.f.cs_force_high = 0;
        WRITE_REG(SEP_AXI_EXTENSION_OCH_SEP_SPI_MUX_CTRL_SPI_MUX_CTRL_REG_ADDR, spi_mux.val);
    }
    printf("SPI mux configured: spi_sel=1 (OpenTitan), cs_force_high=0\n");

    /* Step 2: Enable OT SPI controller (SPIEN=1, OUTPUT_EN=1) */
    ctrl.val = SPI_CONTROLLER_CTRL_REG_DEFAULT;
    ctrl.f.spien = 1;
    ctrl.f.output_en = 1;
    WRITE_REG(SPI_CONTROLLER_CTRL_REG_ADDR, ctrl.val);

    /* Configure clock divider: CLKDIV=9 → SCK = 100 MHz / (2*(9+1)) = 5 MHz */
    {
        SPI_CONTROLLER_CFG_reg_u cfg;
        cfg.val = 0;
        cfg.f.clkdiv = 9;
        cfg.f.csnidle = 2;
        cfg.f.csnlead = 2;
        cfg.f.csntrail = 2;
        WRITE_REG(SPI_CONTROLLER_CFG_REG_ADDR, cfg.val);
    }
    printf("OT SPI controller enabled: SPIEN=1, OUTPUT_EN=1, CLKDIV=9\n");

    /* Step 3: Verify STATUS.READY=1 */
    status.val = READ_REG(SPI_CONTROLLER_STATUS_REG_ADDR);
    printf("  STATUS=0x%08x (READY=%u, TXEMPTY=%u)\n",
           status.val, status.f.ready, status.f.txempty);
    if (status.f.ready != 1) {
        printf("  FAILED: READY not set after SPIEN=1\n");
        pass = 0;
    } else {
        printf("  PASSED: OT SPI controller READY\n");
    }

    /* Step 4: Issue 1-byte TX command (0xAB = dummy), wait for completion */
    if (pass) {
        WRITE_REG(SPI_CONTROLLER_TXDATA_REG_ADDR, 0x000000AB);
        SPI_CONTROLLER_CMD_reg_u cmd;
        cmd.val = 0;
        cmd.f.len       = 0;    /* 1 byte */
        cmd.f.csaat     = 0;
        cmd.f.speed     = 0;    /* Standard */
        cmd.f.direction = 2;    /* TX */
        WRITE_REG(SPI_CONTROLLER_CMD_REG_ADDR, cmd.val);

        /* Wait for READY (cmd consumed and SPI idle) */
        int timeout = 100000;
        do {
            status.val = READ_REG(SPI_CONTROLLER_STATUS_REG_ADDR);
            if (--timeout <= 0) {
                printf("  FAILED: Timeout waiting for READY after TX CMD\n");
                pass = 0;
                break;
            }
        } while (!status.f.ready);

        if (timeout > 0)
            printf("  PASSED: TX command completed (STATUS=0x%08x)\n", status.val);
    }

    /* Step 5: Verify no ERROR_STATUS */
    {
        SPI_CONTROLLER_ERROR_STATUS_reg_u err;
        err.val = READ_REG(SPI_CONTROLLER_ERROR_STATUS_REG_ADDR);
        if (err.val != 0) {
            printf("  FAILED: ERROR_STATUS=0x%08x\n", err.val);
            pass = 0;
        } else {
            printf("  PASSED: No SPI errors\n");
        }
    }

    printf("\n========================================\n");
    if (pass) {
        printf("=== OT SPI SANITY TEST PASSED ===\n");
        printf("========================================\n");
        test_pass(0);
    } else {
        printf("=== OT SPI SANITY TEST FAILED ===\n");
        printf("========================================\n");
        test_fail(0);
    }

    while (1) { __asm__("wfi"); }
    return pass ? 0 : -1;

#else  /* USE_OT_SPI not defined → Cadence xSPI path */

    printf("\n========================================\n");
    printf("OCH SEP Cadence xSPI Sanity Test\n");
    printf("========================================\n");
    printf("\nTesting Cadence xSPI controller initialization\n");
    printf("at 25 MHz with Octal SPI flash (DDR mode)\n\n");

    printf("SPI Control Base: 0x%08x\n", SEP_AXI_EXTENSION_OCH_SEP_CDNS_SPI_CTRL_REG_MAP_BASE_ADDR);
    printf("Cadence xSPI Base: 0x%08x\n", SEP_AXI_EXTENSION_CDNS_XSPI_CTRL_REG_REG_MAP_BASE_ADDR);

    int pass = 1;
    // 100 MHz system clock (testbench)
    uint32_t sys_freq = 100;  // 100 MHz system clock

    // Configure SPI mux: select Cadence controller and clear cs_force_high
    // This must be done FIRST before any SPI controller operations
    configure_spi_mux();

    // ========== 25 MHz Test ==========
    printf("\n========== SPI Test (25 MHz) ==========\n");

    enable_spi_controller(0);
    reset_spi_controller(0);

    printf("  Programming clock divider: 25 MHz (sys=100 MHz, div=4)\n");
    program_spi_clk_div(25, sys_freq);

    printf("  Setting PHY timing parameters (25 MHz, clk_period=40ns)\n");
    set_por_timing_parameter_lowspeed();

    printf("  Configuring discovery: 8-lane DDR\n");
    set_discovery_param(8, 1, 0);

    printf("  Enabling SPI controller\n");
    enable_spi_controller(1);

    // Small delay to ensure enable is stable
    volatile int delay;
    for (delay = 0; delay < 100; delay++) {}

    printf("  Deasserting SPI reset\n");
    reset_spi_controller(1);

    printf("  Waiting for SPI initialization...\n");
    if (try_init_new()) {
        printf("  FAILED: SPI test at 25 MHz\n");
        pass = 0;
    } else {
        printf("  PASSED: SPI test at 25 MHz\n");
    }

    // Final result
    printf("\n========================================\n");
    if (pass) {
        printf("=== SPI SANITY TEST PASSED ===\n");
        printf("25 MHz initialization successful!\n");
        printf("========================================\n");
        test_pass(0);  // Signal testbench: TEST_PASSED
    } else {
        printf("=== SPI SANITY TEST FAILED ===\n");
        printf("========================================\n");
        test_fail(0);  // Signal testbench: TEST_FAILED
    }

    // Keep CPU alive after signaling completion
    while (1) {
        __asm__("wfi");
    }

    return pass ? 0 : -1;

#endif  /* USE_OT_SPI */
}
