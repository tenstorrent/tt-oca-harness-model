## sw/zephyr-smc/boards/tenstorrent/smc_vp/board.yml
```yaml
# SPDX-License-Identifier: Apache-2.0
board:
  name: smc_vp
  full_name: Tenstorrent SMC Virtual Platform
  vendor: tenstorrent
  socs:
    - name: smc
```

## sw/zephyr-smc/soc/tenstorrent/smc/Kconfig
```kconfig
# SPDX-License-Identifier: Apache-2.0

config SOC_SMC
	select RISCV_HAS_PLIC
	select RISCV_ISA_RV64I
	select RISCV_ISA_EXT_M
	select RISCV_ISA_EXT_A
	select RISCV_ISA_EXT_F
	select RISCV_ISA_EXT_D
	select RISCV_ISA_EXT_C
	select RISCV_ISA_EXT_ZICSR
	select RISCV_ISA_EXT_ZIFENCEI
```

## sw/zephyr-smc/soc/tenstorrent/smc/Kconfig.defconfig
```kconfig
# SPDX-License-Identifier: Apache-2.0

if SOC_SMC

config SYS_CLOCK_HW_CYCLES_PER_SEC
	default 100000

config RISCV_SOC_INTERRUPT_INIT
	default y

config 2ND_LVL_ISR_TBL_OFFSET
	default 12

config 2ND_LVL_INTR_00_OFFSET
	default 11

config 2ND_LEVEL_INTERRUPT_BITS
	default 11

config MAX_IRQ_PER_AGGREGATOR
	default 336

config NUM_IRQS
	default 348

config RISCV_HAS_PLIC
	default y

endif # SOC_SMC
```

## sw/zephyr-smc/soc/tenstorrent/smc/Kconfig.soc
```kconfig
# SPDX-License-Identifier: Apache-2.0

config SOC_SMC
	bool
	select RISCV
	select RISCV_PRIVILEGED
	select INCLUDE_RESET_VECTOR
	select RISCV_SOC_HAS_GP_RELATIVE_ADDRESSING

config SOC
	default "smc" if SOC_SMC
```
