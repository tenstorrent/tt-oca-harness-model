/*
 * SPDX-License-Identifier: Apache-2.0
 *
 * Tenstorrent SMC virtual platform board.
 */

/dts-v1/;

#include <riscv/tenstorrent/smc.dtsi>

/ {
	model = "Tenstorrent SMC VP";
	compatible = "tenstorrent,smc-vp";

	chosen {
		zephyr,console = &uart0;
		zephyr,shell-uart = &uart0;
		zephyr,sram = &ram0;
	};
};

&uart0 {
	status = "okay";
};
