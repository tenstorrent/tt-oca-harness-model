// Generated by PeakRDL-regblock - A free and open-source SystemVerilog generator
//  https://github.com/SystemRDL/PeakRDL-regblock

module efuse_shim_ctrl_samsung_reg (
        input wire clk,
        input wire arst_n,

        output logic s_axil_awready,
        input wire s_axil_awvalid,
        input wire [6:0] s_axil_awaddr,
        input wire [2:0] s_axil_awprot,
        output logic s_axil_wready,
        input wire s_axil_wvalid,
        input wire [31:0] s_axil_wdata,
        input wire [3:0]s_axil_wstrb,
        input wire s_axil_bready,
        output logic s_axil_bvalid,
        output logic [1:0] s_axil_bresp,
        output logic s_axil_arready,
        input wire s_axil_arvalid,
        input wire [6:0] s_axil_araddr,
        input wire [2:0] s_axil_arprot,
        input wire s_axil_rready,
        output logic s_axil_rvalid,
        output logic [31:0] s_axil_rdata,
        output logic [1:0] s_axil_rresp,

        output efuse_shim_ctrl_samsung_reg_pkg::efuse_shim_ctrl_samsung__out_t hwif_out
    );

    //--------------------------------------------------------------------------
    // CPU Bus interface logic
    //--------------------------------------------------------------------------
    logic cpuif_req;
    logic cpuif_req_is_wr;
    logic [6:0] cpuif_addr;
    logic [31:0] cpuif_wr_data;
    logic [31:0] cpuif_wr_biten;
    logic cpuif_req_stall_wr;
    logic cpuif_req_stall_rd;

    logic cpuif_rd_ack;
    logic cpuif_rd_err;
    logic [31:0] cpuif_rd_data;

    logic cpuif_wr_ack;
    logic cpuif_wr_err;

    // Max Outstanding Transactions: 2
    logic [1:0] axil_n_in_flight;
    logic axil_prev_was_rd;
    logic axil_arvalid;
    logic [6:0] axil_araddr;
    logic axil_ar_accept;
    logic axil_awvalid;
    logic [6:0] axil_awaddr;
    logic axil_wvalid;
    logic [31:0] axil_wdata;
    logic [3:0] axil_wstrb;
    logic axil_aw_accept;
    logic axil_resp_acked;

    // Transaction request acceptance
    always_ff @(posedge clk or negedge arst_n) begin
        if(~arst_n) begin
            axil_prev_was_rd <= '0;
            axil_arvalid <= '0;
            axil_araddr <= '0;
            axil_awvalid <= '0;
            axil_awaddr <= '0;
            axil_wvalid <= '0;
            axil_wdata <= '0;
            axil_wstrb <= '0;
            axil_n_in_flight <= '0;
        end else begin
            // AR* acceptance register
            if(axil_ar_accept) begin
                axil_prev_was_rd <= '1;
                axil_arvalid <= '0;
            end
            if(s_axil_arvalid && s_axil_arready) begin
                axil_arvalid <= '1;
                axil_araddr <= s_axil_araddr;
            end

            // AW* & W* acceptance registers
            if(axil_aw_accept) begin
                axil_prev_was_rd <= '0;
                axil_awvalid <= '0;
                axil_wvalid <= '0;
            end
            if(s_axil_awvalid && s_axil_awready) begin
                axil_awvalid <= '1;
                axil_awaddr <= s_axil_awaddr;
            end
            if(s_axil_wvalid && s_axil_wready) begin
                axil_wvalid <= '1;
                axil_wdata <= s_axil_wdata;
                axil_wstrb <= s_axil_wstrb;
            end

            // Keep track of in-flight transactions
            if((axil_ar_accept || axil_aw_accept) && !axil_resp_acked) begin
                axil_n_in_flight <= axil_n_in_flight + 1'b1;
            end else if(!(axil_ar_accept || axil_aw_accept) && axil_resp_acked) begin
                axil_n_in_flight <= axil_n_in_flight - 1'b1;
            end
        end
    end

    always_comb begin
        s_axil_arready = (!axil_arvalid || axil_ar_accept);
        s_axil_awready = (!axil_awvalid || axil_aw_accept);
        s_axil_wready = (!axil_wvalid || axil_aw_accept);
    end

    // Request dispatch
    always_comb begin
        cpuif_wr_data = axil_wdata;
        for(int i=0; i<4; i++) begin
            cpuif_wr_biten[i*8 +: 8] = {8{axil_wstrb[i]}};
        end
        cpuif_req = '0;
        cpuif_req_is_wr = '0;
        cpuif_addr = '0;
        axil_ar_accept = '0;
        axil_aw_accept = '0;

        if(axil_n_in_flight < 2'd2) begin
            // Can safely issue more transactions without overwhelming response buffer
            if(axil_arvalid && !axil_prev_was_rd) begin
                cpuif_req = '1;
                cpuif_req_is_wr = '0;
                cpuif_addr = {axil_araddr[6:2], 2'b0};
                if(!cpuif_req_stall_rd) axil_ar_accept = '1;
            end else if(axil_awvalid && axil_wvalid) begin
                cpuif_req = '1;
                cpuif_req_is_wr = '1;
                cpuif_addr = {axil_awaddr[6:2], 2'b0};
                if(!cpuif_req_stall_wr) axil_aw_accept = '1;
            end else if(axil_arvalid) begin
                cpuif_req = '1;
                cpuif_req_is_wr = '0;
                cpuif_addr = {axil_araddr[6:2], 2'b0};
                if(!cpuif_req_stall_rd) axil_ar_accept = '1;
            end
        end
    end


    // AXI4-Lite Response Logic
    struct {
        logic is_wr;
        logic err;
        logic [31:0] rdata;
    } axil_resp_buffer[2];

    logic [1:0] axil_resp_wptr;
    logic [1:0] axil_resp_rptr;

    always_ff @(posedge clk or negedge arst_n) begin
        if(~arst_n) begin
            for(int i=0; i<2; i++) begin
                axil_resp_buffer[i].is_wr <= '0;
                axil_resp_buffer[i].err <= '0;
                axil_resp_buffer[i].rdata <= '0;
            end
            axil_resp_wptr <= '0;
            axil_resp_rptr <= '0;
        end else begin
            // Store responses in buffer until AXI response channel accepts them
            if(cpuif_rd_ack || cpuif_wr_ack) begin
                if(cpuif_rd_ack) begin
                    axil_resp_buffer[axil_resp_wptr[0:0]].is_wr <= '0;
                    axil_resp_buffer[axil_resp_wptr[0:0]].err <= cpuif_rd_err;
                    axil_resp_buffer[axil_resp_wptr[0:0]].rdata <= cpuif_rd_data;

                end else if(cpuif_wr_ack) begin
                    axil_resp_buffer[axil_resp_wptr[0:0]].is_wr <= '1;
                    axil_resp_buffer[axil_resp_wptr[0:0]].err <= cpuif_wr_err;
                end
                axil_resp_wptr <= axil_resp_wptr + 1'b1;
            end

            // Advance read pointer when acknowledged
            if(axil_resp_acked) begin
                axil_resp_rptr <= axil_resp_rptr + 1'b1;
            end
        end
    end

    always_comb begin
        axil_resp_acked = '0;
        s_axil_bvalid = '0;
        s_axil_rvalid = '0;
        if(axil_resp_rptr != axil_resp_wptr) begin
            if(axil_resp_buffer[axil_resp_rptr[0:0]].is_wr) begin
                s_axil_bvalid = '1;
                if(s_axil_bready) axil_resp_acked = '1;
            end else begin
                s_axil_rvalid = '1;
                if(s_axil_rready) axil_resp_acked = '1;
            end
        end

        s_axil_rdata = axil_resp_buffer[axil_resp_rptr[0:0]].rdata;
        if(axil_resp_buffer[axil_resp_rptr[0:0]].err) begin
            s_axil_bresp = 2'b10;
            s_axil_rresp = 2'b10;
        end else begin
            s_axil_bresp = 2'b00;
            s_axil_rresp = 2'b00;
        end
    end

    logic cpuif_req_masked;

    // Read & write latencies are balanced. Stalls not required
    assign cpuif_req_stall_rd = '0;
    assign cpuif_req_stall_wr = '0;
    assign cpuif_req_masked = cpuif_req
                            & !(!cpuif_req_is_wr & cpuif_req_stall_rd)
                            & !(cpuif_req_is_wr & cpuif_req_stall_wr);

    //--------------------------------------------------------------------------
    // Address Decode
    //--------------------------------------------------------------------------
    typedef struct {
        logic EFUSE_CTRL_STATUS;
        logic EFUSE_CTRL_STATUS_1;
        logic EFUSE_TIMING_CTRL_0;
        logic EFUSE_TIMING_CTRL_1;
        logic EFUSE_TIMING_CTRL_2;
        logic EFUSE_TIMING_CTRL_3;
        logic EFUSE_TIMING_CTRL_4;
        logic EFUSE_TIMING_CTRL_5;
        logic EFUSE_TIMING_CTRL_6;
        logic EFUSE_TIMING_CTRL_7;
        logic EFUSE_TIMING_CTRL_8;
        logic EFUSE_TIMING_CTRL_9;
        logic EFUSE_TIMING_CTRL_10;
        logic EFUSE_TIMING_CTRL_11;
        logic EFUSE_TIMING_CTRL_12;
        logic EFUSE_TIMING_CTRL_13;
        logic EFUSE_TIMING_CTRL_14;
    } decoded_reg_strb_t;
    decoded_reg_strb_t decoded_reg_strb;
    logic decoded_req;
    logic decoded_req_is_wr;
    logic [31:0] decoded_wr_data;
    logic [31:0] decoded_wr_biten;

    always_comb begin
        decoded_reg_strb.EFUSE_CTRL_STATUS = cpuif_req_masked & (cpuif_addr == 7'h0);
        decoded_reg_strb.EFUSE_CTRL_STATUS_1 = cpuif_req_masked & (cpuif_addr == 7'h4);
        decoded_reg_strb.EFUSE_TIMING_CTRL_0 = cpuif_req_masked & (cpuif_addr == 7'h8);
        decoded_reg_strb.EFUSE_TIMING_CTRL_1 = cpuif_req_masked & (cpuif_addr == 7'hc);
        decoded_reg_strb.EFUSE_TIMING_CTRL_2 = cpuif_req_masked & (cpuif_addr == 7'h10);
        decoded_reg_strb.EFUSE_TIMING_CTRL_3 = cpuif_req_masked & (cpuif_addr == 7'h14);
        decoded_reg_strb.EFUSE_TIMING_CTRL_4 = cpuif_req_masked & (cpuif_addr == 7'h18);
        decoded_reg_strb.EFUSE_TIMING_CTRL_5 = cpuif_req_masked & (cpuif_addr == 7'h1c);
        decoded_reg_strb.EFUSE_TIMING_CTRL_6 = cpuif_req_masked & (cpuif_addr == 7'h20);
        decoded_reg_strb.EFUSE_TIMING_CTRL_7 = cpuif_req_masked & (cpuif_addr == 7'h24);
        decoded_reg_strb.EFUSE_TIMING_CTRL_8 = cpuif_req_masked & (cpuif_addr == 7'h28);
        decoded_reg_strb.EFUSE_TIMING_CTRL_9 = cpuif_req_masked & (cpuif_addr == 7'h2c);
        decoded_reg_strb.EFUSE_TIMING_CTRL_10 = cpuif_req_masked & (cpuif_addr == 7'h30);
        decoded_reg_strb.EFUSE_TIMING_CTRL_11 = cpuif_req_masked & (cpuif_addr == 7'h34);
        decoded_reg_strb.EFUSE_TIMING_CTRL_12 = cpuif_req_masked & (cpuif_addr == 7'h38);
        decoded_reg_strb.EFUSE_TIMING_CTRL_13 = cpuif_req_masked & (cpuif_addr == 7'h3c);
        decoded_reg_strb.EFUSE_TIMING_CTRL_14 = cpuif_req_masked & (cpuif_addr == 7'h40);
    end

    // Pass down signals to next stage
    assign decoded_req = cpuif_req_masked;
    assign decoded_req_is_wr = cpuif_req_is_wr;
    assign decoded_wr_data = cpuif_wr_data;
    assign decoded_wr_biten = cpuif_wr_biten;

    //--------------------------------------------------------------------------
    // Field logic
    //--------------------------------------------------------------------------
    typedef struct {
        struct {
            struct {
                logic [7:0] next;
                logic load_next;
            } clock_divider_value;
            struct {
                logic [7:0] next;
                logic load_next;
            } clock_dutycycle;
            struct {
                logic next;
                logic load_next;
            } clock_div_enable;
            struct {
                logic next;
                logic load_next;
            } clock_div_set;
        } EFUSE_CTRL_STATUS;
        struct {
            struct {
                logic [12:0] next;
                logic load_next;
            } clk_period_ten_ps;
        } EFUSE_CTRL_STATUS_1;
        struct {
            struct {
                logic [23:0] next;
                logic load_next;
            } tCS_cycles;
        } EFUSE_TIMING_CTRL_0;
        struct {
            struct {
                logic [18:0] next;
                logic load_next;
            } tRW_cycles;
        } EFUSE_TIMING_CTRL_1;
        struct {
            struct {
                logic [15:0] next;
                logic load_next;
            } tAS_cycles;
            struct {
                logic [15:0] next;
                logic load_next;
            } tAH_cycles;
        } EFUSE_TIMING_CTRL_2;
        struct {
            struct {
                logic [31:0] next;
                logic load_next;
            } tCSRST_cycles;
        } EFUSE_TIMING_CTRL_3;
        struct {
            struct {
                logic [15:0] next;
                logic load_next;
            } tRWH_cycles;
            struct {
                logic [15:0] next;
                logic load_next;
            } tRD_cycles;
        } EFUSE_TIMING_CTRL_4;
        struct {
            struct {
                logic [18:0] next;
                logic load_next;
            } tPW_cycles;
        } EFUSE_TIMING_CTRL_5;
        struct {
            struct {
                logic [19:0] next;
                logic load_next;
            } tCPPW_cycles;
        } EFUSE_TIMING_CTRL_6;
        struct {
            struct {
                logic [20:0] next;
                logic load_next;
            } tPGM_cycles;
        } EFUSE_TIMING_CTRL_7;
        struct {
            struct {
                logic [11:0] next;
                logic load_next;
            } tWWL_cycles;
            struct {
                logic [11:0] next;
                logic load_next;
            } tDS_cycles;
        } EFUSE_TIMING_CTRL_8;
        struct {
            struct {
                logic [11:0] next;
                logic load_next;
            } tDH_cycles;
            struct {
                logic [11:0] next;
                logic load_next;
            } tDLES_cycles;
        } EFUSE_TIMING_CTRL_9;
        struct {
            struct {
                logic [16:0] next;
                logic load_next;
            } tPES_cycles;
        } EFUSE_TIMING_CTRL_10;
        struct {
            struct {
                logic [17:0] next;
                logic load_next;
            } tCPS_cycles;
        } EFUSE_TIMING_CTRL_11;
        struct {
            struct {
                logic [16:0] next;
                logic load_next;
            } tCPH_cycles;
            struct {
                logic [11:0] next;
                logic load_next;
            } tPGML_cycles;
        } EFUSE_TIMING_CTRL_12;
        struct {
            struct {
                logic [11:0] next;
                logic load_next;
            } tPGRD_cycles;
        } EFUSE_TIMING_CTRL_13;
        struct {
            struct {
                logic [17:0] next;
                logic load_next;
            } tPEH_cycles;
            struct {
                logic [11:0] next;
                logic load_next;
            } tRSTS_cycles;
        } EFUSE_TIMING_CTRL_14;
    } field_combo_t;
    field_combo_t field_combo;

    typedef struct {
        struct {
            struct {
                logic [7:0] value;
            } clock_divider_value;
            struct {
                logic [7:0] value;
            } clock_dutycycle;
            struct {
                logic value;
            } clock_div_enable;
            struct {
                logic value;
            } clock_div_set;
        } EFUSE_CTRL_STATUS;
        struct {
            struct {
                logic [12:0] value;
            } clk_period_ten_ps;
        } EFUSE_CTRL_STATUS_1;
        struct {
            struct {
                logic [23:0] value;
            } tCS_cycles;
        } EFUSE_TIMING_CTRL_0;
        struct {
            struct {
                logic [18:0] value;
            } tRW_cycles;
        } EFUSE_TIMING_CTRL_1;
        struct {
            struct {
                logic [15:0] value;
            } tAS_cycles;
            struct {
                logic [15:0] value;
            } tAH_cycles;
        } EFUSE_TIMING_CTRL_2;
        struct {
            struct {
                logic [31:0] value;
            } tCSRST_cycles;
        } EFUSE_TIMING_CTRL_3;
        struct {
            struct {
                logic [15:0] value;
            } tRWH_cycles;
            struct {
                logic [15:0] value;
            } tRD_cycles;
        } EFUSE_TIMING_CTRL_4;
        struct {
            struct {
                logic [18:0] value;
            } tPW_cycles;
        } EFUSE_TIMING_CTRL_5;
        struct {
            struct {
                logic [19:0] value;
            } tCPPW_cycles;
        } EFUSE_TIMING_CTRL_6;
        struct {
            struct {
                logic [20:0] value;
            } tPGM_cycles;
        } EFUSE_TIMING_CTRL_7;
        struct {
            struct {
                logic [11:0] value;
            } tWWL_cycles;
            struct {
                logic [11:0] value;
            } tDS_cycles;
        } EFUSE_TIMING_CTRL_8;
        struct {
            struct {
                logic [11:0] value;
            } tDH_cycles;
            struct {
                logic [11:0] value;
            } tDLES_cycles;
        } EFUSE_TIMING_CTRL_9;
        struct {
            struct {
                logic [16:0] value;
            } tPES_cycles;
        } EFUSE_TIMING_CTRL_10;
        struct {
            struct {
                logic [17:0] value;
            } tCPS_cycles;
        } EFUSE_TIMING_CTRL_11;
        struct {
            struct {
                logic [16:0] value;
            } tCPH_cycles;
            struct {
                logic [11:0] value;
            } tPGML_cycles;
        } EFUSE_TIMING_CTRL_12;
        struct {
            struct {
                logic [11:0] value;
            } tPGRD_cycles;
        } EFUSE_TIMING_CTRL_13;
        struct {
            struct {
                logic [17:0] value;
            } tPEH_cycles;
            struct {
                logic [11:0] value;
            } tRSTS_cycles;
        } EFUSE_TIMING_CTRL_14;
    } field_storage_t;
    field_storage_t field_storage;

    // Field: efuse_shim_ctrl_samsung.EFUSE_CTRL_STATUS.clock_divider_value
    always_comb begin
        automatic logic [7:0] next_c;
        automatic logic load_next_c;
        next_c = field_storage.EFUSE_CTRL_STATUS.clock_divider_value.value;
        load_next_c = '0;
        if(decoded_reg_strb.EFUSE_CTRL_STATUS && decoded_req_is_wr) begin // SW write
            next_c = (field_storage.EFUSE_CTRL_STATUS.clock_divider_value.value & ~decoded_wr_biten[7:0]) | (decoded_wr_data[7:0] & decoded_wr_biten[7:0]);
            load_next_c = '1;
        end
        field_combo.EFUSE_CTRL_STATUS.clock_divider_value.next = next_c;
        field_combo.EFUSE_CTRL_STATUS.clock_divider_value.load_next = load_next_c;
    end
    always_ff @(posedge clk or negedge arst_n) begin
        if(~arst_n) begin
            field_storage.EFUSE_CTRL_STATUS.clock_divider_value.value <= 8'h8;
        end else begin
            if(field_combo.EFUSE_CTRL_STATUS.clock_divider_value.load_next) begin
                field_storage.EFUSE_CTRL_STATUS.clock_divider_value.value <= field_combo.EFUSE_CTRL_STATUS.clock_divider_value.next;
            end
        end
    end
    assign hwif_out.EFUSE_CTRL_STATUS.clock_divider_value.value = field_storage.EFUSE_CTRL_STATUS.clock_divider_value.value;
    // Field: efuse_shim_ctrl_samsung.EFUSE_CTRL_STATUS.clock_dutycycle
    always_comb begin
        automatic logic [7:0] next_c;
        automatic logic load_next_c;
        next_c = field_storage.EFUSE_CTRL_STATUS.clock_dutycycle.value;
        load_next_c = '0;
        if(decoded_reg_strb.EFUSE_CTRL_STATUS && decoded_req_is_wr) begin // SW write
            next_c = (field_storage.EFUSE_CTRL_STATUS.clock_dutycycle.value & ~decoded_wr_biten[15:8]) | (decoded_wr_data[15:8] & decoded_wr_biten[15:8]);
            load_next_c = '1;
        end
        field_combo.EFUSE_CTRL_STATUS.clock_dutycycle.next = next_c;
        field_combo.EFUSE_CTRL_STATUS.clock_dutycycle.load_next = load_next_c;
    end
    always_ff @(posedge clk or negedge arst_n) begin
        if(~arst_n) begin
            field_storage.EFUSE_CTRL_STATUS.clock_dutycycle.value <= 8'h1;
        end else begin
            if(field_combo.EFUSE_CTRL_STATUS.clock_dutycycle.load_next) begin
                field_storage.EFUSE_CTRL_STATUS.clock_dutycycle.value <= field_combo.EFUSE_CTRL_STATUS.clock_dutycycle.next;
            end
        end
    end
    assign hwif_out.EFUSE_CTRL_STATUS.clock_dutycycle.value = field_storage.EFUSE_CTRL_STATUS.clock_dutycycle.value;
    // Field: efuse_shim_ctrl_samsung.EFUSE_CTRL_STATUS.clock_div_enable
    always_comb begin
        automatic logic [0:0] next_c;
        automatic logic load_next_c;
        next_c = field_storage.EFUSE_CTRL_STATUS.clock_div_enable.value;
        load_next_c = '0;
        if(decoded_reg_strb.EFUSE_CTRL_STATUS && decoded_req_is_wr) begin // SW write
            next_c = (field_storage.EFUSE_CTRL_STATUS.clock_div_enable.value & ~decoded_wr_biten[16:16]) | (decoded_wr_data[16:16] & decoded_wr_biten[16:16]);
            load_next_c = '1;
        end
        field_combo.EFUSE_CTRL_STATUS.clock_div_enable.next = next_c;
        field_combo.EFUSE_CTRL_STATUS.clock_div_enable.load_next = load_next_c;
    end
    always_ff @(posedge clk or negedge arst_n) begin
        if(~arst_n) begin
            field_storage.EFUSE_CTRL_STATUS.clock_div_enable.value <= 1'h1;
        end else begin
            if(field_combo.EFUSE_CTRL_STATUS.clock_div_enable.load_next) begin
                field_storage.EFUSE_CTRL_STATUS.clock_div_enable.value <= field_combo.EFUSE_CTRL_STATUS.clock_div_enable.next;
            end
        end
    end
    assign hwif_out.EFUSE_CTRL_STATUS.clock_div_enable.value = field_storage.EFUSE_CTRL_STATUS.clock_div_enable.value;
    // Field: efuse_shim_ctrl_samsung.EFUSE_CTRL_STATUS.clock_div_set
    always_comb begin
        automatic logic [0:0] next_c;
        automatic logic load_next_c;
        next_c = field_storage.EFUSE_CTRL_STATUS.clock_div_set.value;
        load_next_c = '0;
        if(decoded_reg_strb.EFUSE_CTRL_STATUS && decoded_req_is_wr) begin // SW write
            next_c = (field_storage.EFUSE_CTRL_STATUS.clock_div_set.value & ~decoded_wr_biten[17:17]) | (decoded_wr_data[17:17] & decoded_wr_biten[17:17]);
            load_next_c = '1;
        end else begin // singlepulse clears back to 0
            next_c = '0;
            load_next_c = '1;
        end
        field_combo.EFUSE_CTRL_STATUS.clock_div_set.next = next_c;
        field_combo.EFUSE_CTRL_STATUS.clock_div_set.load_next = load_next_c;
    end
    always_ff @(posedge clk or negedge arst_n) begin
        if(~arst_n) begin
            field_storage.EFUSE_CTRL_STATUS.clock_div_set.value <= 1'h0;
        end else begin
            if(field_combo.EFUSE_CTRL_STATUS.clock_div_set.load_next) begin
                field_storage.EFUSE_CTRL_STATUS.clock_div_set.value <= field_combo.EFUSE_CTRL_STATUS.clock_div_set.next;
            end
        end
    end
    assign hwif_out.EFUSE_CTRL_STATUS.clock_div_set.value = field_storage.EFUSE_CTRL_STATUS.clock_div_set.value;
    // Field: efuse_shim_ctrl_samsung.EFUSE_CTRL_STATUS_1.clk_period_ten_ps
    always_comb begin
        automatic logic [12:0] next_c;
        automatic logic load_next_c;
        next_c = field_storage.EFUSE_CTRL_STATUS_1.clk_period_ten_ps.value;
        load_next_c = '0;
        if(decoded_reg_strb.EFUSE_CTRL_STATUS_1 && decoded_req_is_wr) begin // SW write
            next_c = (field_storage.EFUSE_CTRL_STATUS_1.clk_period_ten_ps.value & ~decoded_wr_biten[12:0]) | (decoded_wr_data[12:0] & decoded_wr_biten[12:0]);
            load_next_c = '1;
        end
        field_combo.EFUSE_CTRL_STATUS_1.clk_period_ten_ps.next = next_c;
        field_combo.EFUSE_CTRL_STATUS_1.clk_period_ten_ps.load_next = load_next_c;
    end
    always_ff @(posedge clk or negedge arst_n) begin
        if(~arst_n) begin
            field_storage.EFUSE_CTRL_STATUS_1.clk_period_ten_ps.value <= 13'h3e8;
        end else begin
            if(field_combo.EFUSE_CTRL_STATUS_1.clk_period_ten_ps.load_next) begin
                field_storage.EFUSE_CTRL_STATUS_1.clk_period_ten_ps.value <= field_combo.EFUSE_CTRL_STATUS_1.clk_period_ten_ps.next;
            end
        end
    end
    assign hwif_out.EFUSE_CTRL_STATUS_1.clk_period_ten_ps.value = field_storage.EFUSE_CTRL_STATUS_1.clk_period_ten_ps.value;
    // Field: efuse_shim_ctrl_samsung.EFUSE_TIMING_CTRL_0.tCS_cycles
    always_comb begin
        automatic logic [23:0] next_c;
        automatic logic load_next_c;
        next_c = field_storage.EFUSE_TIMING_CTRL_0.tCS_cycles.value;
        load_next_c = '0;
        if(decoded_reg_strb.EFUSE_TIMING_CTRL_0 && decoded_req_is_wr) begin // SW write
            next_c = (field_storage.EFUSE_TIMING_CTRL_0.tCS_cycles.value & ~decoded_wr_biten[23:0]) | (decoded_wr_data[23:0] & decoded_wr_biten[23:0]);
            load_next_c = '1;
        end
        field_combo.EFUSE_TIMING_CTRL_0.tCS_cycles.next = next_c;
        field_combo.EFUSE_TIMING_CTRL_0.tCS_cycles.load_next = load_next_c;
    end
    always_ff @(posedge clk or negedge arst_n) begin
        if(~arst_n) begin
            field_storage.EFUSE_TIMING_CTRL_0.tCS_cycles.value <= 24'h5b8d80;
        end else begin
            if(field_combo.EFUSE_TIMING_CTRL_0.tCS_cycles.load_next) begin
                field_storage.EFUSE_TIMING_CTRL_0.tCS_cycles.value <= field_combo.EFUSE_TIMING_CTRL_0.tCS_cycles.next;
            end
        end
    end
    assign hwif_out.EFUSE_TIMING_CTRL_0.tCS_cycles.value = field_storage.EFUSE_TIMING_CTRL_0.tCS_cycles.value;
    // Field: efuse_shim_ctrl_samsung.EFUSE_TIMING_CTRL_1.tRW_cycles
    always_comb begin
        automatic logic [18:0] next_c;
        automatic logic load_next_c;
        next_c = field_storage.EFUSE_TIMING_CTRL_1.tRW_cycles.value;
        load_next_c = '0;
        if(decoded_reg_strb.EFUSE_TIMING_CTRL_1 && decoded_req_is_wr) begin // SW write
            next_c = (field_storage.EFUSE_TIMING_CTRL_1.tRW_cycles.value & ~decoded_wr_biten[18:0]) | (decoded_wr_data[18:0] & decoded_wr_biten[18:0]);
            load_next_c = '1;
        end
        field_combo.EFUSE_TIMING_CTRL_1.tRW_cycles.next = next_c;
        field_combo.EFUSE_TIMING_CTRL_1.tRW_cycles.load_next = load_next_c;
    end
    always_ff @(posedge clk or negedge arst_n) begin
        if(~arst_n) begin
            field_storage.EFUSE_TIMING_CTRL_1.tRW_cycles.value <= 19'h1d4c0;
        end else begin
            if(field_combo.EFUSE_TIMING_CTRL_1.tRW_cycles.load_next) begin
                field_storage.EFUSE_TIMING_CTRL_1.tRW_cycles.value <= field_combo.EFUSE_TIMING_CTRL_1.tRW_cycles.next;
            end
        end
    end
    assign hwif_out.EFUSE_TIMING_CTRL_1.tRW_cycles.value = field_storage.EFUSE_TIMING_CTRL_1.tRW_cycles.value;
    // Field: efuse_shim_ctrl_samsung.EFUSE_TIMING_CTRL_2.tAS_cycles
    always_comb begin
        automatic logic [15:0] next_c;
        automatic logic load_next_c;
        next_c = field_storage.EFUSE_TIMING_CTRL_2.tAS_cycles.value;
        load_next_c = '0;
        if(decoded_reg_strb.EFUSE_TIMING_CTRL_2 && decoded_req_is_wr) begin // SW write
            next_c = (field_storage.EFUSE_TIMING_CTRL_2.tAS_cycles.value & ~decoded_wr_biten[15:0]) | (decoded_wr_data[15:0] & decoded_wr_biten[15:0]);
            load_next_c = '1;
        end
        field_combo.EFUSE_TIMING_CTRL_2.tAS_cycles.next = next_c;
        field_combo.EFUSE_TIMING_CTRL_2.tAS_cycles.load_next = load_next_c;
    end
    always_ff @(posedge clk or negedge arst_n) begin
        if(~arst_n) begin
            field_storage.EFUSE_TIMING_CTRL_2.tAS_cycles.value <= 16'h960;
        end else begin
            if(field_combo.EFUSE_TIMING_CTRL_2.tAS_cycles.load_next) begin
                field_storage.EFUSE_TIMING_CTRL_2.tAS_cycles.value <= field_combo.EFUSE_TIMING_CTRL_2.tAS_cycles.next;
            end
        end
    end
    assign hwif_out.EFUSE_TIMING_CTRL_2.tAS_cycles.value = field_storage.EFUSE_TIMING_CTRL_2.tAS_cycles.value;
    // Field: efuse_shim_ctrl_samsung.EFUSE_TIMING_CTRL_2.tAH_cycles
    always_comb begin
        automatic logic [15:0] next_c;
        automatic logic load_next_c;
        next_c = field_storage.EFUSE_TIMING_CTRL_2.tAH_cycles.value;
        load_next_c = '0;
        if(decoded_reg_strb.EFUSE_TIMING_CTRL_2 && decoded_req_is_wr) begin // SW write
            next_c = (field_storage.EFUSE_TIMING_CTRL_2.tAH_cycles.value & ~decoded_wr_biten[31:16]) | (decoded_wr_data[31:16] & decoded_wr_biten[31:16]);
            load_next_c = '1;
        end
        field_combo.EFUSE_TIMING_CTRL_2.tAH_cycles.next = next_c;
        field_combo.EFUSE_TIMING_CTRL_2.tAH_cycles.load_next = load_next_c;
    end
    always_ff @(posedge clk or negedge arst_n) begin
        if(~arst_n) begin
            field_storage.EFUSE_TIMING_CTRL_2.tAH_cycles.value <= 16'h960;
        end else begin
            if(field_combo.EFUSE_TIMING_CTRL_2.tAH_cycles.load_next) begin
                field_storage.EFUSE_TIMING_CTRL_2.tAH_cycles.value <= field_combo.EFUSE_TIMING_CTRL_2.tAH_cycles.next;
            end
        end
    end
    assign hwif_out.EFUSE_TIMING_CTRL_2.tAH_cycles.value = field_storage.EFUSE_TIMING_CTRL_2.tAH_cycles.value;
    // Field: efuse_shim_ctrl_samsung.EFUSE_TIMING_CTRL_3.tCSRST_cycles
    always_comb begin
        automatic logic [31:0] next_c;
        automatic logic load_next_c;
        next_c = field_storage.EFUSE_TIMING_CTRL_3.tCSRST_cycles.value;
        load_next_c = '0;
        if(decoded_reg_strb.EFUSE_TIMING_CTRL_3 && decoded_req_is_wr) begin // SW write
            next_c = (field_storage.EFUSE_TIMING_CTRL_3.tCSRST_cycles.value & ~decoded_wr_biten[31:0]) | (decoded_wr_data[31:0] & decoded_wr_biten[31:0]);
            load_next_c = '1;
        end
        field_combo.EFUSE_TIMING_CTRL_3.tCSRST_cycles.next = next_c;
        field_combo.EFUSE_TIMING_CTRL_3.tCSRST_cycles.load_next = load_next_c;
    end
    always_ff @(posedge clk or negedge arst_n) begin
        if(~arst_n) begin
            field_storage.EFUSE_TIMING_CTRL_3.tCSRST_cycles.value <= 32'hb71b00;
        end else begin
            if(field_combo.EFUSE_TIMING_CTRL_3.tCSRST_cycles.load_next) begin
                field_storage.EFUSE_TIMING_CTRL_3.tCSRST_cycles.value <= field_combo.EFUSE_TIMING_CTRL_3.tCSRST_cycles.next;
            end
        end
    end
    assign hwif_out.EFUSE_TIMING_CTRL_3.tCSRST_cycles.value = field_storage.EFUSE_TIMING_CTRL_3.tCSRST_cycles.value;
    // Field: efuse_shim_ctrl_samsung.EFUSE_TIMING_CTRL_4.tRWH_cycles
    always_comb begin
        automatic logic [15:0] next_c;
        automatic logic load_next_c;
        next_c = field_storage.EFUSE_TIMING_CTRL_4.tRWH_cycles.value;
        load_next_c = '0;
        if(decoded_reg_strb.EFUSE_TIMING_CTRL_4 && decoded_req_is_wr) begin // SW write
            next_c = (field_storage.EFUSE_TIMING_CTRL_4.tRWH_cycles.value & ~decoded_wr_biten[15:0]) | (decoded_wr_data[15:0] & decoded_wr_biten[15:0]);
            load_next_c = '1;
        end
        field_combo.EFUSE_TIMING_CTRL_4.tRWH_cycles.next = next_c;
        field_combo.EFUSE_TIMING_CTRL_4.tRWH_cycles.load_next = load_next_c;
    end
    always_ff @(posedge clk or negedge arst_n) begin
        if(~arst_n) begin
            field_storage.EFUSE_TIMING_CTRL_4.tRWH_cycles.value <= 16'h55f0;
        end else begin
            if(field_combo.EFUSE_TIMING_CTRL_4.tRWH_cycles.load_next) begin
                field_storage.EFUSE_TIMING_CTRL_4.tRWH_cycles.value <= field_combo.EFUSE_TIMING_CTRL_4.tRWH_cycles.next;
            end
        end
    end
    assign hwif_out.EFUSE_TIMING_CTRL_4.tRWH_cycles.value = field_storage.EFUSE_TIMING_CTRL_4.tRWH_cycles.value;
    // Field: efuse_shim_ctrl_samsung.EFUSE_TIMING_CTRL_4.tRD_cycles
    always_comb begin
        automatic logic [15:0] next_c;
        automatic logic load_next_c;
        next_c = field_storage.EFUSE_TIMING_CTRL_4.tRD_cycles.value;
        load_next_c = '0;
        if(decoded_reg_strb.EFUSE_TIMING_CTRL_4 && decoded_req_is_wr) begin // SW write
            next_c = (field_storage.EFUSE_TIMING_CTRL_4.tRD_cycles.value & ~decoded_wr_biten[31:16]) | (decoded_wr_data[31:16] & decoded_wr_biten[31:16]);
            load_next_c = '1;
        end
        field_combo.EFUSE_TIMING_CTRL_4.tRD_cycles.next = next_c;
        field_combo.EFUSE_TIMING_CTRL_4.tRD_cycles.load_next = load_next_c;
    end
    always_ff @(posedge clk or negedge arst_n) begin
        if(~arst_n) begin
            field_storage.EFUSE_TIMING_CTRL_4.tRD_cycles.value <= 16'h3200;
        end else begin
            if(field_combo.EFUSE_TIMING_CTRL_4.tRD_cycles.load_next) begin
                field_storage.EFUSE_TIMING_CTRL_4.tRD_cycles.value <= field_combo.EFUSE_TIMING_CTRL_4.tRD_cycles.next;
            end
        end
    end
    assign hwif_out.EFUSE_TIMING_CTRL_4.tRD_cycles.value = field_storage.EFUSE_TIMING_CTRL_4.tRD_cycles.value;
    // Field: efuse_shim_ctrl_samsung.EFUSE_TIMING_CTRL_5.tPW_cycles
    always_comb begin
        automatic logic [18:0] next_c;
        automatic logic load_next_c;
        next_c = field_storage.EFUSE_TIMING_CTRL_5.tPW_cycles.value;
        load_next_c = '0;
        if(decoded_reg_strb.EFUSE_TIMING_CTRL_5 && decoded_req_is_wr) begin // SW write
            next_c = (field_storage.EFUSE_TIMING_CTRL_5.tPW_cycles.value & ~decoded_wr_biten[18:0]) | (decoded_wr_data[18:0] & decoded_wr_biten[18:0]);
            load_next_c = '1;
        end
        field_combo.EFUSE_TIMING_CTRL_5.tPW_cycles.next = next_c;
        field_combo.EFUSE_TIMING_CTRL_5.tPW_cycles.load_next = load_next_c;
    end
    always_ff @(posedge clk or negedge arst_n) begin
        if(~arst_n) begin
            field_storage.EFUSE_TIMING_CTRL_5.tPW_cycles.value <= 19'h35b60;
        end else begin
            if(field_combo.EFUSE_TIMING_CTRL_5.tPW_cycles.load_next) begin
                field_storage.EFUSE_TIMING_CTRL_5.tPW_cycles.value <= field_combo.EFUSE_TIMING_CTRL_5.tPW_cycles.next;
            end
        end
    end
    assign hwif_out.EFUSE_TIMING_CTRL_5.tPW_cycles.value = field_storage.EFUSE_TIMING_CTRL_5.tPW_cycles.value;
    // Field: efuse_shim_ctrl_samsung.EFUSE_TIMING_CTRL_6.tCPPW_cycles
    always_comb begin
        automatic logic [19:0] next_c;
        automatic logic load_next_c;
        next_c = field_storage.EFUSE_TIMING_CTRL_6.tCPPW_cycles.value;
        load_next_c = '0;
        if(decoded_reg_strb.EFUSE_TIMING_CTRL_6 && decoded_req_is_wr) begin // SW write
            next_c = (field_storage.EFUSE_TIMING_CTRL_6.tCPPW_cycles.value & ~decoded_wr_biten[19:0]) | (decoded_wr_data[19:0] & decoded_wr_biten[19:0]);
            load_next_c = '1;
        end
        field_combo.EFUSE_TIMING_CTRL_6.tCPPW_cycles.next = next_c;
        field_combo.EFUSE_TIMING_CTRL_6.tCPPW_cycles.load_next = load_next_c;
    end
    always_ff @(posedge clk or negedge arst_n) begin
        if(~arst_n) begin
            field_storage.EFUSE_TIMING_CTRL_6.tCPPW_cycles.value <= 20'h61a80;
        end else begin
            if(field_combo.EFUSE_TIMING_CTRL_6.tCPPW_cycles.load_next) begin
                field_storage.EFUSE_TIMING_CTRL_6.tCPPW_cycles.value <= field_combo.EFUSE_TIMING_CTRL_6.tCPPW_cycles.next;
            end
        end
    end
    assign hwif_out.EFUSE_TIMING_CTRL_6.tCPPW_cycles.value = field_storage.EFUSE_TIMING_CTRL_6.tCPPW_cycles.value;
    // Field: efuse_shim_ctrl_samsung.EFUSE_TIMING_CTRL_7.tPGM_cycles
    always_comb begin
        automatic logic [20:0] next_c;
        automatic logic load_next_c;
        next_c = field_storage.EFUSE_TIMING_CTRL_7.tPGM_cycles.value;
        load_next_c = '0;
        if(decoded_reg_strb.EFUSE_TIMING_CTRL_7 && decoded_req_is_wr) begin // SW write
            next_c = (field_storage.EFUSE_TIMING_CTRL_7.tPGM_cycles.value & ~decoded_wr_biten[20:0]) | (decoded_wr_data[20:0] & decoded_wr_biten[20:0]);
            load_next_c = '1;
        end
        field_combo.EFUSE_TIMING_CTRL_7.tPGM_cycles.next = next_c;
        field_combo.EFUSE_TIMING_CTRL_7.tPGM_cycles.load_next = load_next_c;
    end
    always_ff @(posedge clk or negedge arst_n) begin
        if(~arst_n) begin
            field_storage.EFUSE_TIMING_CTRL_7.tPGM_cycles.value <= 21'h927c0;
        end else begin
            if(field_combo.EFUSE_TIMING_CTRL_7.tPGM_cycles.load_next) begin
                field_storage.EFUSE_TIMING_CTRL_7.tPGM_cycles.value <= field_combo.EFUSE_TIMING_CTRL_7.tPGM_cycles.next;
            end
        end
    end
    assign hwif_out.EFUSE_TIMING_CTRL_7.tPGM_cycles.value = field_storage.EFUSE_TIMING_CTRL_7.tPGM_cycles.value;
    // Field: efuse_shim_ctrl_samsung.EFUSE_TIMING_CTRL_8.tWWL_cycles
    always_comb begin
        automatic logic [11:0] next_c;
        automatic logic load_next_c;
        next_c = field_storage.EFUSE_TIMING_CTRL_8.tWWL_cycles.value;
        load_next_c = '0;
        if(decoded_reg_strb.EFUSE_TIMING_CTRL_8 && decoded_req_is_wr) begin // SW write
            next_c = (field_storage.EFUSE_TIMING_CTRL_8.tWWL_cycles.value & ~decoded_wr_biten[11:0]) | (decoded_wr_data[11:0] & decoded_wr_biten[11:0]);
            load_next_c = '1;
        end
        field_combo.EFUSE_TIMING_CTRL_8.tWWL_cycles.next = next_c;
        field_combo.EFUSE_TIMING_CTRL_8.tWWL_cycles.load_next = load_next_c;
    end
    always_ff @(posedge clk or negedge arst_n) begin
        if(~arst_n) begin
            field_storage.EFUSE_TIMING_CTRL_8.tWWL_cycles.value <= 12'h960;
        end else begin
            if(field_combo.EFUSE_TIMING_CTRL_8.tWWL_cycles.load_next) begin
                field_storage.EFUSE_TIMING_CTRL_8.tWWL_cycles.value <= field_combo.EFUSE_TIMING_CTRL_8.tWWL_cycles.next;
            end
        end
    end
    assign hwif_out.EFUSE_TIMING_CTRL_8.tWWL_cycles.value = field_storage.EFUSE_TIMING_CTRL_8.tWWL_cycles.value;
    // Field: efuse_shim_ctrl_samsung.EFUSE_TIMING_CTRL_8.tDS_cycles
    always_comb begin
        automatic logic [11:0] next_c;
        automatic logic load_next_c;
        next_c = field_storage.EFUSE_TIMING_CTRL_8.tDS_cycles.value;
        load_next_c = '0;
        if(decoded_reg_strb.EFUSE_TIMING_CTRL_8 && decoded_req_is_wr) begin // SW write
            next_c = (field_storage.EFUSE_TIMING_CTRL_8.tDS_cycles.value & ~decoded_wr_biten[23:12]) | (decoded_wr_data[23:12] & decoded_wr_biten[23:12]);
            load_next_c = '1;
        end
        field_combo.EFUSE_TIMING_CTRL_8.tDS_cycles.next = next_c;
        field_combo.EFUSE_TIMING_CTRL_8.tDS_cycles.load_next = load_next_c;
    end
    always_ff @(posedge clk or negedge arst_n) begin
        if(~arst_n) begin
            field_storage.EFUSE_TIMING_CTRL_8.tDS_cycles.value <= 12'h960;
        end else begin
            if(field_combo.EFUSE_TIMING_CTRL_8.tDS_cycles.load_next) begin
                field_storage.EFUSE_TIMING_CTRL_8.tDS_cycles.value <= field_combo.EFUSE_TIMING_CTRL_8.tDS_cycles.next;
            end
        end
    end
    assign hwif_out.EFUSE_TIMING_CTRL_8.tDS_cycles.value = field_storage.EFUSE_TIMING_CTRL_8.tDS_cycles.value;
    // Field: efuse_shim_ctrl_samsung.EFUSE_TIMING_CTRL_9.tDH_cycles
    always_comb begin
        automatic logic [11:0] next_c;
        automatic logic load_next_c;
        next_c = field_storage.EFUSE_TIMING_CTRL_9.tDH_cycles.value;
        load_next_c = '0;
        if(decoded_reg_strb.EFUSE_TIMING_CTRL_9 && decoded_req_is_wr) begin // SW write
            next_c = (field_storage.EFUSE_TIMING_CTRL_9.tDH_cycles.value & ~decoded_wr_biten[11:0]) | (decoded_wr_data[11:0] & decoded_wr_biten[11:0]);
            load_next_c = '1;
        end
        field_combo.EFUSE_TIMING_CTRL_9.tDH_cycles.next = next_c;
        field_combo.EFUSE_TIMING_CTRL_9.tDH_cycles.load_next = load_next_c;
    end
    always_ff @(posedge clk or negedge arst_n) begin
        if(~arst_n) begin
            field_storage.EFUSE_TIMING_CTRL_9.tDH_cycles.value <= 12'h960;
        end else begin
            if(field_combo.EFUSE_TIMING_CTRL_9.tDH_cycles.load_next) begin
                field_storage.EFUSE_TIMING_CTRL_9.tDH_cycles.value <= field_combo.EFUSE_TIMING_CTRL_9.tDH_cycles.next;
            end
        end
    end
    assign hwif_out.EFUSE_TIMING_CTRL_9.tDH_cycles.value = field_storage.EFUSE_TIMING_CTRL_9.tDH_cycles.value;
    // Field: efuse_shim_ctrl_samsung.EFUSE_TIMING_CTRL_9.tDLES_cycles
    always_comb begin
        automatic logic [11:0] next_c;
        automatic logic load_next_c;
        next_c = field_storage.EFUSE_TIMING_CTRL_9.tDLES_cycles.value;
        load_next_c = '0;
        if(decoded_reg_strb.EFUSE_TIMING_CTRL_9 && decoded_req_is_wr) begin // SW write
            next_c = (field_storage.EFUSE_TIMING_CTRL_9.tDLES_cycles.value & ~decoded_wr_biten[23:12]) | (decoded_wr_data[23:12] & decoded_wr_biten[23:12]);
            load_next_c = '1;
        end
        field_combo.EFUSE_TIMING_CTRL_9.tDLES_cycles.next = next_c;
        field_combo.EFUSE_TIMING_CTRL_9.tDLES_cycles.load_next = load_next_c;
    end
    always_ff @(posedge clk or negedge arst_n) begin
        if(~arst_n) begin
            field_storage.EFUSE_TIMING_CTRL_9.tDLES_cycles.value <= 12'h960;
        end else begin
            if(field_combo.EFUSE_TIMING_CTRL_9.tDLES_cycles.load_next) begin
                field_storage.EFUSE_TIMING_CTRL_9.tDLES_cycles.value <= field_combo.EFUSE_TIMING_CTRL_9.tDLES_cycles.next;
            end
        end
    end
    assign hwif_out.EFUSE_TIMING_CTRL_9.tDLES_cycles.value = field_storage.EFUSE_TIMING_CTRL_9.tDLES_cycles.value;
    // Field: efuse_shim_ctrl_samsung.EFUSE_TIMING_CTRL_10.tPES_cycles
    always_comb begin
        automatic logic [16:0] next_c;
        automatic logic load_next_c;
        next_c = field_storage.EFUSE_TIMING_CTRL_10.tPES_cycles.value;
        load_next_c = '0;
        if(decoded_reg_strb.EFUSE_TIMING_CTRL_10 && decoded_req_is_wr) begin // SW write
            next_c = (field_storage.EFUSE_TIMING_CTRL_10.tPES_cycles.value & ~decoded_wr_biten[16:0]) | (decoded_wr_data[16:0] & decoded_wr_biten[16:0]);
            load_next_c = '1;
        end
        field_combo.EFUSE_TIMING_CTRL_10.tPES_cycles.next = next_c;
        field_combo.EFUSE_TIMING_CTRL_10.tPES_cycles.load_next = load_next_c;
    end
    always_ff @(posedge clk or negedge arst_n) begin
        if(~arst_n) begin
            field_storage.EFUSE_TIMING_CTRL_10.tPES_cycles.value <= 17'hea60;
        end else begin
            if(field_combo.EFUSE_TIMING_CTRL_10.tPES_cycles.load_next) begin
                field_storage.EFUSE_TIMING_CTRL_10.tPES_cycles.value <= field_combo.EFUSE_TIMING_CTRL_10.tPES_cycles.next;
            end
        end
    end
    assign hwif_out.EFUSE_TIMING_CTRL_10.tPES_cycles.value = field_storage.EFUSE_TIMING_CTRL_10.tPES_cycles.value;
    // Field: efuse_shim_ctrl_samsung.EFUSE_TIMING_CTRL_11.tCPS_cycles
    always_comb begin
        automatic logic [17:0] next_c;
        automatic logic load_next_c;
        next_c = field_storage.EFUSE_TIMING_CTRL_11.tCPS_cycles.value;
        load_next_c = '0;
        if(decoded_reg_strb.EFUSE_TIMING_CTRL_11 && decoded_req_is_wr) begin // SW write
            next_c = (field_storage.EFUSE_TIMING_CTRL_11.tCPS_cycles.value & ~decoded_wr_biten[17:0]) | (decoded_wr_data[17:0] & decoded_wr_biten[17:0]);
            load_next_c = '1;
        end
        field_combo.EFUSE_TIMING_CTRL_11.tCPS_cycles.next = next_c;
        field_combo.EFUSE_TIMING_CTRL_11.tCPS_cycles.load_next = load_next_c;
    end
    always_ff @(posedge clk or negedge arst_n) begin
        if(~arst_n) begin
            field_storage.EFUSE_TIMING_CTRL_11.tCPS_cycles.value <= 18'h1d4c0;
        end else begin
            if(field_combo.EFUSE_TIMING_CTRL_11.tCPS_cycles.load_next) begin
                field_storage.EFUSE_TIMING_CTRL_11.tCPS_cycles.value <= field_combo.EFUSE_TIMING_CTRL_11.tCPS_cycles.next;
            end
        end
    end
    assign hwif_out.EFUSE_TIMING_CTRL_11.tCPS_cycles.value = field_storage.EFUSE_TIMING_CTRL_11.tCPS_cycles.value;
    // Field: efuse_shim_ctrl_samsung.EFUSE_TIMING_CTRL_12.tCPH_cycles
    always_comb begin
        automatic logic [16:0] next_c;
        automatic logic load_next_c;
        next_c = field_storage.EFUSE_TIMING_CTRL_12.tCPH_cycles.value;
        load_next_c = '0;
        if(decoded_reg_strb.EFUSE_TIMING_CTRL_12 && decoded_req_is_wr) begin // SW write
            next_c = (field_storage.EFUSE_TIMING_CTRL_12.tCPH_cycles.value & ~decoded_wr_biten[16:0]) | (decoded_wr_data[16:0] & decoded_wr_biten[16:0]);
            load_next_c = '1;
        end
        field_combo.EFUSE_TIMING_CTRL_12.tCPH_cycles.next = next_c;
        field_combo.EFUSE_TIMING_CTRL_12.tCPH_cycles.load_next = load_next_c;
    end
    always_ff @(posedge clk or negedge arst_n) begin
        if(~arst_n) begin
            field_storage.EFUSE_TIMING_CTRL_12.tCPH_cycles.value <= 17'hea60;
        end else begin
            if(field_combo.EFUSE_TIMING_CTRL_12.tCPH_cycles.load_next) begin
                field_storage.EFUSE_TIMING_CTRL_12.tCPH_cycles.value <= field_combo.EFUSE_TIMING_CTRL_12.tCPH_cycles.next;
            end
        end
    end
    assign hwif_out.EFUSE_TIMING_CTRL_12.tCPH_cycles.value = field_storage.EFUSE_TIMING_CTRL_12.tCPH_cycles.value;
    // Field: efuse_shim_ctrl_samsung.EFUSE_TIMING_CTRL_12.tPGML_cycles
    always_comb begin
        automatic logic [11:0] next_c;
        automatic logic load_next_c;
        next_c = field_storage.EFUSE_TIMING_CTRL_12.tPGML_cycles.value;
        load_next_c = '0;
        if(decoded_reg_strb.EFUSE_TIMING_CTRL_12 && decoded_req_is_wr) begin // SW write
            next_c = (field_storage.EFUSE_TIMING_CTRL_12.tPGML_cycles.value & ~decoded_wr_biten[28:17]) | (decoded_wr_data[28:17] & decoded_wr_biten[28:17]);
            load_next_c = '1;
        end
        field_combo.EFUSE_TIMING_CTRL_12.tPGML_cycles.next = next_c;
        field_combo.EFUSE_TIMING_CTRL_12.tPGML_cycles.load_next = load_next_c;
    end
    always_ff @(posedge clk or negedge arst_n) begin
        if(~arst_n) begin
            field_storage.EFUSE_TIMING_CTRL_12.tPGML_cycles.value <= 12'h960;
        end else begin
            if(field_combo.EFUSE_TIMING_CTRL_12.tPGML_cycles.load_next) begin
                field_storage.EFUSE_TIMING_CTRL_12.tPGML_cycles.value <= field_combo.EFUSE_TIMING_CTRL_12.tPGML_cycles.next;
            end
        end
    end
    assign hwif_out.EFUSE_TIMING_CTRL_12.tPGML_cycles.value = field_storage.EFUSE_TIMING_CTRL_12.tPGML_cycles.value;
    // Field: efuse_shim_ctrl_samsung.EFUSE_TIMING_CTRL_13.tPGRD_cycles
    always_comb begin
        automatic logic [11:0] next_c;
        automatic logic load_next_c;
        next_c = field_storage.EFUSE_TIMING_CTRL_13.tPGRD_cycles.value;
        load_next_c = '0;
        if(decoded_reg_strb.EFUSE_TIMING_CTRL_13 && decoded_req_is_wr) begin // SW write
            next_c = (field_storage.EFUSE_TIMING_CTRL_13.tPGRD_cycles.value & ~decoded_wr_biten[11:0]) | (decoded_wr_data[11:0] & decoded_wr_biten[11:0]);
            load_next_c = '1;
        end
        field_combo.EFUSE_TIMING_CTRL_13.tPGRD_cycles.next = next_c;
        field_combo.EFUSE_TIMING_CTRL_13.tPGRD_cycles.load_next = load_next_c;
    end
    always_ff @(posedge clk or negedge arst_n) begin
        if(~arst_n) begin
            field_storage.EFUSE_TIMING_CTRL_13.tPGRD_cycles.value <= 12'h960;
        end else begin
            if(field_combo.EFUSE_TIMING_CTRL_13.tPGRD_cycles.load_next) begin
                field_storage.EFUSE_TIMING_CTRL_13.tPGRD_cycles.value <= field_combo.EFUSE_TIMING_CTRL_13.tPGRD_cycles.next;
            end
        end
    end
    assign hwif_out.EFUSE_TIMING_CTRL_13.tPGRD_cycles.value = field_storage.EFUSE_TIMING_CTRL_13.tPGRD_cycles.value;
    // Field: efuse_shim_ctrl_samsung.EFUSE_TIMING_CTRL_14.tPEH_cycles
    always_comb begin
        automatic logic [17:0] next_c;
        automatic logic load_next_c;
        next_c = field_storage.EFUSE_TIMING_CTRL_14.tPEH_cycles.value;
        load_next_c = '0;
        if(decoded_reg_strb.EFUSE_TIMING_CTRL_14 && decoded_req_is_wr) begin // SW write
            next_c = (field_storage.EFUSE_TIMING_CTRL_14.tPEH_cycles.value & ~decoded_wr_biten[17:0]) | (decoded_wr_data[17:0] & decoded_wr_biten[17:0]);
            load_next_c = '1;
        end
        field_combo.EFUSE_TIMING_CTRL_14.tPEH_cycles.next = next_c;
        field_combo.EFUSE_TIMING_CTRL_14.tPEH_cycles.load_next = load_next_c;
    end
    always_ff @(posedge clk or negedge arst_n) begin
        if(~arst_n) begin
            field_storage.EFUSE_TIMING_CTRL_14.tPEH_cycles.value <= 18'h1d4c0;
        end else begin
            if(field_combo.EFUSE_TIMING_CTRL_14.tPEH_cycles.load_next) begin
                field_storage.EFUSE_TIMING_CTRL_14.tPEH_cycles.value <= field_combo.EFUSE_TIMING_CTRL_14.tPEH_cycles.next;
            end
        end
    end
    assign hwif_out.EFUSE_TIMING_CTRL_14.tPEH_cycles.value = field_storage.EFUSE_TIMING_CTRL_14.tPEH_cycles.value;
    // Field: efuse_shim_ctrl_samsung.EFUSE_TIMING_CTRL_14.tRSTS_cycles
    always_comb begin
        automatic logic [11:0] next_c;
        automatic logic load_next_c;
        next_c = field_storage.EFUSE_TIMING_CTRL_14.tRSTS_cycles.value;
        load_next_c = '0;
        if(decoded_reg_strb.EFUSE_TIMING_CTRL_14 && decoded_req_is_wr) begin // SW write
            next_c = (field_storage.EFUSE_TIMING_CTRL_14.tRSTS_cycles.value & ~decoded_wr_biten[29:18]) | (decoded_wr_data[29:18] & decoded_wr_biten[29:18]);
            load_next_c = '1;
        end
        field_combo.EFUSE_TIMING_CTRL_14.tRSTS_cycles.next = next_c;
        field_combo.EFUSE_TIMING_CTRL_14.tRSTS_cycles.load_next = load_next_c;
    end
    always_ff @(posedge clk or negedge arst_n) begin
        if(~arst_n) begin
            field_storage.EFUSE_TIMING_CTRL_14.tRSTS_cycles.value <= 12'h960;
        end else begin
            if(field_combo.EFUSE_TIMING_CTRL_14.tRSTS_cycles.load_next) begin
                field_storage.EFUSE_TIMING_CTRL_14.tRSTS_cycles.value <= field_combo.EFUSE_TIMING_CTRL_14.tRSTS_cycles.next;
            end
        end
    end
    assign hwif_out.EFUSE_TIMING_CTRL_14.tRSTS_cycles.value = field_storage.EFUSE_TIMING_CTRL_14.tRSTS_cycles.value;

    //--------------------------------------------------------------------------
    // Write response
    //--------------------------------------------------------------------------
    assign cpuif_wr_ack = decoded_req & decoded_req_is_wr;
    // Writes are always granted with no error response
    assign cpuif_wr_err = '0;

    //--------------------------------------------------------------------------
    // Readback
    //--------------------------------------------------------------------------

    logic readback_err;
    logic readback_done;
    logic [31:0] readback_data;

    // Assign readback values to a flattened array
    logic [31:0] readback_array[17];
    assign readback_array[0][7:0] = (decoded_reg_strb.EFUSE_CTRL_STATUS && !decoded_req_is_wr) ? field_storage.EFUSE_CTRL_STATUS.clock_divider_value.value : '0;
    assign readback_array[0][15:8] = (decoded_reg_strb.EFUSE_CTRL_STATUS && !decoded_req_is_wr) ? field_storage.EFUSE_CTRL_STATUS.clock_dutycycle.value : '0;
    assign readback_array[0][16:16] = (decoded_reg_strb.EFUSE_CTRL_STATUS && !decoded_req_is_wr) ? field_storage.EFUSE_CTRL_STATUS.clock_div_enable.value : '0;
    assign readback_array[0][17:17] = (decoded_reg_strb.EFUSE_CTRL_STATUS && !decoded_req_is_wr) ? field_storage.EFUSE_CTRL_STATUS.clock_div_set.value : '0;
    assign readback_array[0][31:18] = '0;
    assign readback_array[1][12:0] = (decoded_reg_strb.EFUSE_CTRL_STATUS_1 && !decoded_req_is_wr) ? field_storage.EFUSE_CTRL_STATUS_1.clk_period_ten_ps.value : '0;
    assign readback_array[1][31:13] = '0;
    assign readback_array[2][23:0] = (decoded_reg_strb.EFUSE_TIMING_CTRL_0 && !decoded_req_is_wr) ? field_storage.EFUSE_TIMING_CTRL_0.tCS_cycles.value : '0;
    assign readback_array[2][31:24] = '0;
    assign readback_array[3][18:0] = (decoded_reg_strb.EFUSE_TIMING_CTRL_1 && !decoded_req_is_wr) ? field_storage.EFUSE_TIMING_CTRL_1.tRW_cycles.value : '0;
    assign readback_array[3][31:19] = '0;
    assign readback_array[4][15:0] = (decoded_reg_strb.EFUSE_TIMING_CTRL_2 && !decoded_req_is_wr) ? field_storage.EFUSE_TIMING_CTRL_2.tAS_cycles.value : '0;
    assign readback_array[4][31:16] = (decoded_reg_strb.EFUSE_TIMING_CTRL_2 && !decoded_req_is_wr) ? field_storage.EFUSE_TIMING_CTRL_2.tAH_cycles.value : '0;
    assign readback_array[5][31:0] = (decoded_reg_strb.EFUSE_TIMING_CTRL_3 && !decoded_req_is_wr) ? field_storage.EFUSE_TIMING_CTRL_3.tCSRST_cycles.value : '0;
    assign readback_array[6][15:0] = (decoded_reg_strb.EFUSE_TIMING_CTRL_4 && !decoded_req_is_wr) ? field_storage.EFUSE_TIMING_CTRL_4.tRWH_cycles.value : '0;
    assign readback_array[6][31:16] = (decoded_reg_strb.EFUSE_TIMING_CTRL_4 && !decoded_req_is_wr) ? field_storage.EFUSE_TIMING_CTRL_4.tRD_cycles.value : '0;
    assign readback_array[7][18:0] = (decoded_reg_strb.EFUSE_TIMING_CTRL_5 && !decoded_req_is_wr) ? field_storage.EFUSE_TIMING_CTRL_5.tPW_cycles.value : '0;
    assign readback_array[7][31:19] = '0;
    assign readback_array[8][19:0] = (decoded_reg_strb.EFUSE_TIMING_CTRL_6 && !decoded_req_is_wr) ? field_storage.EFUSE_TIMING_CTRL_6.tCPPW_cycles.value : '0;
    assign readback_array[8][31:20] = '0;
    assign readback_array[9][20:0] = (decoded_reg_strb.EFUSE_TIMING_CTRL_7 && !decoded_req_is_wr) ? field_storage.EFUSE_TIMING_CTRL_7.tPGM_cycles.value : '0;
    assign readback_array[9][31:21] = '0;
    assign readback_array[10][11:0] = (decoded_reg_strb.EFUSE_TIMING_CTRL_8 && !decoded_req_is_wr) ? field_storage.EFUSE_TIMING_CTRL_8.tWWL_cycles.value : '0;
    assign readback_array[10][23:12] = (decoded_reg_strb.EFUSE_TIMING_CTRL_8 && !decoded_req_is_wr) ? field_storage.EFUSE_TIMING_CTRL_8.tDS_cycles.value : '0;
    assign readback_array[10][31:24] = '0;
    assign readback_array[11][11:0] = (decoded_reg_strb.EFUSE_TIMING_CTRL_9 && !decoded_req_is_wr) ? field_storage.EFUSE_TIMING_CTRL_9.tDH_cycles.value : '0;
    assign readback_array[11][23:12] = (decoded_reg_strb.EFUSE_TIMING_CTRL_9 && !decoded_req_is_wr) ? field_storage.EFUSE_TIMING_CTRL_9.tDLES_cycles.value : '0;
    assign readback_array[11][31:24] = '0;
    assign readback_array[12][16:0] = (decoded_reg_strb.EFUSE_TIMING_CTRL_10 && !decoded_req_is_wr) ? field_storage.EFUSE_TIMING_CTRL_10.tPES_cycles.value : '0;
    assign readback_array[12][31:17] = '0;
    assign readback_array[13][17:0] = (decoded_reg_strb.EFUSE_TIMING_CTRL_11 && !decoded_req_is_wr) ? field_storage.EFUSE_TIMING_CTRL_11.tCPS_cycles.value : '0;
    assign readback_array[13][31:18] = '0;
    assign readback_array[14][16:0] = (decoded_reg_strb.EFUSE_TIMING_CTRL_12 && !decoded_req_is_wr) ? field_storage.EFUSE_TIMING_CTRL_12.tCPH_cycles.value : '0;
    assign readback_array[14][28:17] = (decoded_reg_strb.EFUSE_TIMING_CTRL_12 && !decoded_req_is_wr) ? field_storage.EFUSE_TIMING_CTRL_12.tPGML_cycles.value : '0;
    assign readback_array[14][31:29] = '0;
    assign readback_array[15][11:0] = (decoded_reg_strb.EFUSE_TIMING_CTRL_13 && !decoded_req_is_wr) ? field_storage.EFUSE_TIMING_CTRL_13.tPGRD_cycles.value : '0;
    assign readback_array[15][31:12] = '0;
    assign readback_array[16][17:0] = (decoded_reg_strb.EFUSE_TIMING_CTRL_14 && !decoded_req_is_wr) ? field_storage.EFUSE_TIMING_CTRL_14.tPEH_cycles.value : '0;
    assign readback_array[16][29:18] = (decoded_reg_strb.EFUSE_TIMING_CTRL_14 && !decoded_req_is_wr) ? field_storage.EFUSE_TIMING_CTRL_14.tRSTS_cycles.value : '0;
    assign readback_array[16][31:30] = '0;

    // Reduce the array
    always_comb begin
        automatic logic [31:0] readback_data_var;
        readback_done = decoded_req & ~decoded_req_is_wr;
        readback_err = '0;
        readback_data_var = '0;
        for(int i=0; i<17; i++) readback_data_var |= readback_array[i];
        readback_data = readback_data_var;
    end

    assign cpuif_rd_ack = readback_done;
    assign cpuif_rd_data = readback_data;
    assign cpuif_rd_err = readback_err;
endmodule
