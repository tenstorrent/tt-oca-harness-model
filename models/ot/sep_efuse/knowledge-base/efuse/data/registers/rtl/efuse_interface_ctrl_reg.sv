// Generated by PeakRDL-regblock - A free and open-source SystemVerilog generator
//  https://github.com/SystemRDL/PeakRDL-regblock

module efuse_interface_ctrl_reg (
        input wire clk,
        input wire arst_n,

        input wire s_apb_psel,
        input wire s_apb_penable,
        input wire s_apb_pwrite,
        input wire [2:0] s_apb_pprot,
        input wire [4:0] s_apb_paddr,
        input wire [31:0] s_apb_pwdata,
        input wire [3:0] s_apb_pstrb,
        output logic s_apb_pready,
        output logic [31:0] s_apb_prdata,
        output logic s_apb_pslverr,

        input efuse_interface_ctrl_reg_pkg::efuse_interface_ctrl__in_t hwif_in,
        output efuse_interface_ctrl_reg_pkg::efuse_interface_ctrl__out_t hwif_out
    );

    //--------------------------------------------------------------------------
    // CPU Bus interface logic
    //--------------------------------------------------------------------------
    logic cpuif_req;
    logic cpuif_req_is_wr;
    logic [4:0] cpuif_addr;
    logic [31:0] cpuif_wr_data;
    logic [31:0] cpuif_wr_biten;
    logic cpuif_req_stall_wr;
    logic cpuif_req_stall_rd;

    logic cpuif_rd_ack;
    logic cpuif_rd_err;
    logic [31:0] cpuif_rd_data;

    logic cpuif_wr_ack;
    logic cpuif_wr_err;

    // Request
    logic is_active;
    always_ff @(posedge clk or negedge arst_n) begin
        if(~arst_n) begin
            is_active <= '0;
            cpuif_req <= '0;
            cpuif_req_is_wr <= '0;
            cpuif_addr <= '0;
            cpuif_wr_data <= '0;
            cpuif_wr_biten <= '0;
        end else begin
            if(~is_active) begin
                if(s_apb_psel) begin
                    is_active <= '1;
                    cpuif_req <= '1;
                    cpuif_req_is_wr <= s_apb_pwrite;
                    cpuif_addr <= {s_apb_paddr[4:2], 2'b0};
                    cpuif_wr_data <= s_apb_pwdata;
                    for(int i=0; i<4; i++) begin
                        cpuif_wr_biten[i*8 +: 8] <= {8{s_apb_pstrb[i]}};
                    end
                end
            end else begin
                cpuif_req <= '0;
                if(cpuif_rd_ack || cpuif_wr_ack) begin
                    is_active <= '0;
                end
            end
        end
    end

    // Response
    assign s_apb_pready = cpuif_rd_ack | cpuif_wr_ack;
    assign s_apb_prdata = cpuif_rd_data;
    assign s_apb_pslverr = cpuif_rd_err | cpuif_wr_err;

    logic cpuif_req_masked;

    // Read & write latencies are balanced. Stalls not required
    assign cpuif_req_stall_rd = '0;
    assign cpuif_req_stall_wr = '0;
    assign cpuif_req_masked = cpuif_req
                            & !(!cpuif_req_is_wr & cpuif_req_stall_rd)
                            & !(cpuif_req_is_wr & cpuif_req_stall_wr);

    //--------------------------------------------------------------------------
    // Address Decode
    //--------------------------------------------------------------------------
    typedef struct {
        logic EFUSE_INTERFACE_CTRL_STATUS;
        logic EFUSE_WRITE_CTRL;
        logic EFUSE_READ_CTRL;
        logic EFUSE_PROGRAM_INTERFACE_READ_DATA;
        logic EFUSE_READ_INTERFACE_READ_DATA;
        logic EFUSE_READ_REQ_TIMEOUT;
        logic EFUSE_PROGRAM_REQ_TIMEOUT;
    } decoded_reg_strb_t;
    decoded_reg_strb_t decoded_reg_strb;
    logic decoded_err;
    logic decoded_req;
    logic decoded_req_is_wr;
    logic [31:0] decoded_wr_data;
    logic [31:0] decoded_wr_biten;

    always_comb begin
        automatic logic is_valid_addr;
        automatic logic is_invalid_rw;
        is_valid_addr = '1; // No error checking on valid address access
        is_invalid_rw = '0;
        decoded_reg_strb.EFUSE_INTERFACE_CTRL_STATUS = cpuif_req_masked & (cpuif_addr == 5'h0);
        decoded_reg_strb.EFUSE_WRITE_CTRL = cpuif_req_masked & (cpuif_addr == 5'h4);
        decoded_reg_strb.EFUSE_READ_CTRL = cpuif_req_masked & (cpuif_addr == 5'h8);
        decoded_reg_strb.EFUSE_PROGRAM_INTERFACE_READ_DATA = cpuif_req_masked & (cpuif_addr == 5'hc) & !cpuif_req_is_wr;
        decoded_reg_strb.EFUSE_READ_INTERFACE_READ_DATA = cpuif_req_masked & (cpuif_addr == 5'h10) & !cpuif_req_is_wr;
        decoded_reg_strb.EFUSE_READ_REQ_TIMEOUT = cpuif_req_masked & (cpuif_addr == 5'h14);
        decoded_reg_strb.EFUSE_PROGRAM_REQ_TIMEOUT = cpuif_req_masked & (cpuif_addr == 5'h18);
        decoded_err = (~is_valid_addr | is_invalid_rw) & decoded_req;
    end

    // Pass down signals to next stage
    assign decoded_req = cpuif_req_masked;
    assign decoded_req_is_wr = cpuif_req_is_wr;
    assign decoded_wr_data = cpuif_wr_data;
    assign decoded_wr_biten = cpuif_wr_biten;

    //--------------------------------------------------------------------------
    // Field logic
    //--------------------------------------------------------------------------
    typedef struct {
        struct {
            struct {
                logic next;
                logic load_next;
            } efuse_req_err_clear;
        } EFUSE_INTERFACE_CTRL_STATUS;
        struct {
            struct {
                logic [15:0] next;
                logic load_next;
            } efuse_addr;
            struct {
                logic next;
                logic load_next;
            } efuse_data;
            struct {
                logic next;
                logic load_next;
            } efuse_write_go;
            struct {
                logic next;
                logic load_next;
            } efuse_program_read_back;
            struct {
                logic next;
                logic load_next;
            } program_enable;
        } EFUSE_WRITE_CTRL;
        struct {
            struct {
                logic [15:0] next;
                logic load_next;
            } efuse_addr;
            struct {
                logic next;
                logic load_next;
            } efuse_read_go;
            struct {
                logic next;
                logic load_next;
            } read_enable;
        } EFUSE_READ_CTRL;
        struct {
            struct {
                logic [27:0] next;
                logic load_next;
            } read_req_timeout_cycles;
            struct {
                logic next;
                logic load_next;
            } read_req_timout_enable;
        } EFUSE_READ_REQ_TIMEOUT;
        struct {
            struct {
                logic [27:0] next;
                logic load_next;
            } program_req_timeout_cycles;
            struct {
                logic next;
                logic load_next;
            } program_req_timeout_enable;
        } EFUSE_PROGRAM_REQ_TIMEOUT;
    } field_combo_t;
    field_combo_t field_combo;

    typedef struct {
        struct {
            struct {
                logic value;
            } efuse_req_err_clear;
        } EFUSE_INTERFACE_CTRL_STATUS;
        struct {
            struct {
                logic [15:0] value;
            } efuse_addr;
            struct {
                logic value;
            } efuse_data;
            struct {
                logic value;
            } efuse_write_go;
            struct {
                logic value;
            } efuse_program_read_back;
            struct {
                logic value;
            } program_enable;
        } EFUSE_WRITE_CTRL;
        struct {
            struct {
                logic [15:0] value;
            } efuse_addr;
            struct {
                logic value;
            } efuse_read_go;
            struct {
                logic value;
            } read_enable;
        } EFUSE_READ_CTRL;
        struct {
            struct {
                logic [27:0] value;
            } read_req_timeout_cycles;
            struct {
                logic value;
            } read_req_timout_enable;
        } EFUSE_READ_REQ_TIMEOUT;
        struct {
            struct {
                logic [27:0] value;
            } program_req_timeout_cycles;
            struct {
                logic value;
            } program_req_timeout_enable;
        } EFUSE_PROGRAM_REQ_TIMEOUT;
    } field_storage_t;
    field_storage_t field_storage;

    // Field: efuse_interface_ctrl.EFUSE_INTERFACE_CTRL_STATUS.efuse_req_err_clear
    always_comb begin
        automatic logic [0:0] next_c;
        automatic logic load_next_c;
        next_c = field_storage.EFUSE_INTERFACE_CTRL_STATUS.efuse_req_err_clear.value;
        load_next_c = '0;
        if(decoded_reg_strb.EFUSE_INTERFACE_CTRL_STATUS && decoded_req_is_wr) begin // SW write
            next_c = (field_storage.EFUSE_INTERFACE_CTRL_STATUS.efuse_req_err_clear.value & ~decoded_wr_biten[8:8]) | (decoded_wr_data[8:8] & decoded_wr_biten[8:8]);
            load_next_c = '1;
        end else begin // singlepulse clears back to 0
            next_c = '0;
            load_next_c = '1;
        end
        field_combo.EFUSE_INTERFACE_CTRL_STATUS.efuse_req_err_clear.next = next_c;
        field_combo.EFUSE_INTERFACE_CTRL_STATUS.efuse_req_err_clear.load_next = load_next_c;
    end
    always_ff @(posedge clk or negedge arst_n) begin
        if(~arst_n) begin
            field_storage.EFUSE_INTERFACE_CTRL_STATUS.efuse_req_err_clear.value <= 1'h0;
        end else begin
            if(field_combo.EFUSE_INTERFACE_CTRL_STATUS.efuse_req_err_clear.load_next) begin
                field_storage.EFUSE_INTERFACE_CTRL_STATUS.efuse_req_err_clear.value <= field_combo.EFUSE_INTERFACE_CTRL_STATUS.efuse_req_err_clear.next;
            end
        end
    end
    assign hwif_out.EFUSE_INTERFACE_CTRL_STATUS.efuse_req_err_clear.value = field_storage.EFUSE_INTERFACE_CTRL_STATUS.efuse_req_err_clear.value;
    // Field: efuse_interface_ctrl.EFUSE_WRITE_CTRL.efuse_addr
    always_comb begin
        automatic logic [15:0] next_c;
        automatic logic load_next_c;
        next_c = field_storage.EFUSE_WRITE_CTRL.efuse_addr.value;
        load_next_c = '0;
        if(decoded_reg_strb.EFUSE_WRITE_CTRL && decoded_req_is_wr) begin // SW write
            next_c = (field_storage.EFUSE_WRITE_CTRL.efuse_addr.value & ~decoded_wr_biten[15:0]) | (decoded_wr_data[15:0] & decoded_wr_biten[15:0]);
            load_next_c = '1;
        end
        field_combo.EFUSE_WRITE_CTRL.efuse_addr.next = next_c;
        field_combo.EFUSE_WRITE_CTRL.efuse_addr.load_next = load_next_c;
    end
    always_ff @(posedge clk or negedge arst_n) begin
        if(~arst_n) begin
            field_storage.EFUSE_WRITE_CTRL.efuse_addr.value <= 16'h0;
        end else begin
            if(field_combo.EFUSE_WRITE_CTRL.efuse_addr.load_next) begin
                field_storage.EFUSE_WRITE_CTRL.efuse_addr.value <= field_combo.EFUSE_WRITE_CTRL.efuse_addr.next;
            end
        end
    end
    assign hwif_out.EFUSE_WRITE_CTRL.efuse_addr.value = field_storage.EFUSE_WRITE_CTRL.efuse_addr.value;
    // Field: efuse_interface_ctrl.EFUSE_WRITE_CTRL.efuse_data
    always_comb begin
        automatic logic [0:0] next_c;
        automatic logic load_next_c;
        next_c = field_storage.EFUSE_WRITE_CTRL.efuse_data.value;
        load_next_c = '0;
        if(decoded_reg_strb.EFUSE_WRITE_CTRL && decoded_req_is_wr) begin // SW write
            next_c = (field_storage.EFUSE_WRITE_CTRL.efuse_data.value & ~decoded_wr_biten[16:16]) | (decoded_wr_data[16:16] & decoded_wr_biten[16:16]);
            load_next_c = '1;
        end
        field_combo.EFUSE_WRITE_CTRL.efuse_data.next = next_c;
        field_combo.EFUSE_WRITE_CTRL.efuse_data.load_next = load_next_c;
    end
    always_ff @(posedge clk or negedge arst_n) begin
        if(~arst_n) begin
            field_storage.EFUSE_WRITE_CTRL.efuse_data.value <= 1'h0;
        end else begin
            if(field_combo.EFUSE_WRITE_CTRL.efuse_data.load_next) begin
                field_storage.EFUSE_WRITE_CTRL.efuse_data.value <= field_combo.EFUSE_WRITE_CTRL.efuse_data.next;
            end
        end
    end
    assign hwif_out.EFUSE_WRITE_CTRL.efuse_data.value = field_storage.EFUSE_WRITE_CTRL.efuse_data.value;
    // Field: efuse_interface_ctrl.EFUSE_WRITE_CTRL.efuse_write_go
    always_comb begin
        automatic logic [0:0] next_c;
        automatic logic load_next_c;
        next_c = field_storage.EFUSE_WRITE_CTRL.efuse_write_go.value;
        load_next_c = '0;
        if(decoded_reg_strb.EFUSE_WRITE_CTRL && decoded_req_is_wr) begin // SW write
            next_c = (field_storage.EFUSE_WRITE_CTRL.efuse_write_go.value & ~decoded_wr_biten[17:17]) | (decoded_wr_data[17:17] & decoded_wr_biten[17:17]);
            load_next_c = '1;
        end else begin // singlepulse clears back to 0
            next_c = '0;
            load_next_c = '1;
        end
        field_combo.EFUSE_WRITE_CTRL.efuse_write_go.next = next_c;
        field_combo.EFUSE_WRITE_CTRL.efuse_write_go.load_next = load_next_c;
    end
    always_ff @(posedge clk or negedge arst_n) begin
        if(~arst_n) begin
            field_storage.EFUSE_WRITE_CTRL.efuse_write_go.value <= 1'h0;
        end else begin
            if(field_combo.EFUSE_WRITE_CTRL.efuse_write_go.load_next) begin
                field_storage.EFUSE_WRITE_CTRL.efuse_write_go.value <= field_combo.EFUSE_WRITE_CTRL.efuse_write_go.next;
            end
        end
    end
    assign hwif_out.EFUSE_WRITE_CTRL.efuse_write_go.value = field_storage.EFUSE_WRITE_CTRL.efuse_write_go.value;
    // Field: efuse_interface_ctrl.EFUSE_WRITE_CTRL.efuse_program_read_back
    always_comb begin
        automatic logic [0:0] next_c;
        automatic logic load_next_c;
        next_c = field_storage.EFUSE_WRITE_CTRL.efuse_program_read_back.value;
        load_next_c = '0;
        if(decoded_reg_strb.EFUSE_WRITE_CTRL && decoded_req_is_wr) begin // SW write
            next_c = (field_storage.EFUSE_WRITE_CTRL.efuse_program_read_back.value & ~decoded_wr_biten[18:18]) | (decoded_wr_data[18:18] & decoded_wr_biten[18:18]);
            load_next_c = '1;
        end
        field_combo.EFUSE_WRITE_CTRL.efuse_program_read_back.next = next_c;
        field_combo.EFUSE_WRITE_CTRL.efuse_program_read_back.load_next = load_next_c;
    end
    always_ff @(posedge clk or negedge arst_n) begin
        if(~arst_n) begin
            field_storage.EFUSE_WRITE_CTRL.efuse_program_read_back.value <= 1'h0;
        end else begin
            if(field_combo.EFUSE_WRITE_CTRL.efuse_program_read_back.load_next) begin
                field_storage.EFUSE_WRITE_CTRL.efuse_program_read_back.value <= field_combo.EFUSE_WRITE_CTRL.efuse_program_read_back.next;
            end
        end
    end
    assign hwif_out.EFUSE_WRITE_CTRL.efuse_program_read_back.value = field_storage.EFUSE_WRITE_CTRL.efuse_program_read_back.value;
    // Field: efuse_interface_ctrl.EFUSE_WRITE_CTRL.program_enable
    always_comb begin
        automatic logic [0:0] next_c;
        automatic logic load_next_c;
        next_c = field_storage.EFUSE_WRITE_CTRL.program_enable.value;
        load_next_c = '0;
        if(decoded_reg_strb.EFUSE_WRITE_CTRL && decoded_req_is_wr) begin // SW write
            next_c = (field_storage.EFUSE_WRITE_CTRL.program_enable.value & ~decoded_wr_biten[27:27]) | (decoded_wr_data[27:27] & decoded_wr_biten[27:27]);
            load_next_c = '1;
        end
        field_combo.EFUSE_WRITE_CTRL.program_enable.next = next_c;
        field_combo.EFUSE_WRITE_CTRL.program_enable.load_next = load_next_c;
    end
    always_ff @(posedge clk or negedge arst_n) begin
        if(~arst_n) begin
            field_storage.EFUSE_WRITE_CTRL.program_enable.value <= 1'h0;
        end else begin
            if(field_combo.EFUSE_WRITE_CTRL.program_enable.load_next) begin
                field_storage.EFUSE_WRITE_CTRL.program_enable.value <= field_combo.EFUSE_WRITE_CTRL.program_enable.next;
            end
        end
    end
    assign hwif_out.EFUSE_WRITE_CTRL.program_enable.value = field_storage.EFUSE_WRITE_CTRL.program_enable.value;
    // Field: efuse_interface_ctrl.EFUSE_READ_CTRL.efuse_addr
    always_comb begin
        automatic logic [15:0] next_c;
        automatic logic load_next_c;
        next_c = field_storage.EFUSE_READ_CTRL.efuse_addr.value;
        load_next_c = '0;
        if(decoded_reg_strb.EFUSE_READ_CTRL && decoded_req_is_wr) begin // SW write
            next_c = (field_storage.EFUSE_READ_CTRL.efuse_addr.value & ~decoded_wr_biten[15:0]) | (decoded_wr_data[15:0] & decoded_wr_biten[15:0]);
            load_next_c = '1;
        end
        field_combo.EFUSE_READ_CTRL.efuse_addr.next = next_c;
        field_combo.EFUSE_READ_CTRL.efuse_addr.load_next = load_next_c;
    end
    always_ff @(posedge clk or negedge arst_n) begin
        if(~arst_n) begin
            field_storage.EFUSE_READ_CTRL.efuse_addr.value <= 16'h0;
        end else begin
            if(field_combo.EFUSE_READ_CTRL.efuse_addr.load_next) begin
                field_storage.EFUSE_READ_CTRL.efuse_addr.value <= field_combo.EFUSE_READ_CTRL.efuse_addr.next;
            end
        end
    end
    assign hwif_out.EFUSE_READ_CTRL.efuse_addr.value = field_storage.EFUSE_READ_CTRL.efuse_addr.value;
    // Field: efuse_interface_ctrl.EFUSE_READ_CTRL.efuse_read_go
    always_comb begin
        automatic logic [0:0] next_c;
        automatic logic load_next_c;
        next_c = field_storage.EFUSE_READ_CTRL.efuse_read_go.value;
        load_next_c = '0;
        if(decoded_reg_strb.EFUSE_READ_CTRL && decoded_req_is_wr) begin // SW write
            next_c = (field_storage.EFUSE_READ_CTRL.efuse_read_go.value & ~decoded_wr_biten[16:16]) | (decoded_wr_data[16:16] & decoded_wr_biten[16:16]);
            load_next_c = '1;
        end else begin // singlepulse clears back to 0
            next_c = '0;
            load_next_c = '1;
        end
        field_combo.EFUSE_READ_CTRL.efuse_read_go.next = next_c;
        field_combo.EFUSE_READ_CTRL.efuse_read_go.load_next = load_next_c;
    end
    always_ff @(posedge clk or negedge arst_n) begin
        if(~arst_n) begin
            field_storage.EFUSE_READ_CTRL.efuse_read_go.value <= 1'h0;
        end else begin
            if(field_combo.EFUSE_READ_CTRL.efuse_read_go.load_next) begin
                field_storage.EFUSE_READ_CTRL.efuse_read_go.value <= field_combo.EFUSE_READ_CTRL.efuse_read_go.next;
            end
        end
    end
    assign hwif_out.EFUSE_READ_CTRL.efuse_read_go.value = field_storage.EFUSE_READ_CTRL.efuse_read_go.value;
    // Field: efuse_interface_ctrl.EFUSE_READ_CTRL.read_enable
    always_comb begin
        automatic logic [0:0] next_c;
        automatic logic load_next_c;
        next_c = field_storage.EFUSE_READ_CTRL.read_enable.value;
        load_next_c = '0;
        if(decoded_reg_strb.EFUSE_READ_CTRL && decoded_req_is_wr) begin // SW write
            next_c = (field_storage.EFUSE_READ_CTRL.read_enable.value & ~decoded_wr_biten[28:28]) | (decoded_wr_data[28:28] & decoded_wr_biten[28:28]);
            load_next_c = '1;
        end
        field_combo.EFUSE_READ_CTRL.read_enable.next = next_c;
        field_combo.EFUSE_READ_CTRL.read_enable.load_next = load_next_c;
    end
    always_ff @(posedge clk or negedge arst_n) begin
        if(~arst_n) begin
            field_storage.EFUSE_READ_CTRL.read_enable.value <= 1'h0;
        end else begin
            if(field_combo.EFUSE_READ_CTRL.read_enable.load_next) begin
                field_storage.EFUSE_READ_CTRL.read_enable.value <= field_combo.EFUSE_READ_CTRL.read_enable.next;
            end
        end
    end
    assign hwif_out.EFUSE_READ_CTRL.read_enable.value = field_storage.EFUSE_READ_CTRL.read_enable.value;
    // Field: efuse_interface_ctrl.EFUSE_READ_REQ_TIMEOUT.read_req_timeout_cycles
    always_comb begin
        automatic logic [27:0] next_c;
        automatic logic load_next_c;
        next_c = field_storage.EFUSE_READ_REQ_TIMEOUT.read_req_timeout_cycles.value;
        load_next_c = '0;
        if(decoded_reg_strb.EFUSE_READ_REQ_TIMEOUT && decoded_req_is_wr) begin // SW write
            next_c = (field_storage.EFUSE_READ_REQ_TIMEOUT.read_req_timeout_cycles.value & ~decoded_wr_biten[27:0]) | (decoded_wr_data[27:0] & decoded_wr_biten[27:0]);
            load_next_c = '1;
        end
        field_combo.EFUSE_READ_REQ_TIMEOUT.read_req_timeout_cycles.next = next_c;
        field_combo.EFUSE_READ_REQ_TIMEOUT.read_req_timeout_cycles.load_next = load_next_c;
    end
    always_ff @(posedge clk or negedge arst_n) begin
        if(~arst_n) begin
            field_storage.EFUSE_READ_REQ_TIMEOUT.read_req_timeout_cycles.value <= 28'h800000;
        end else begin
            if(field_combo.EFUSE_READ_REQ_TIMEOUT.read_req_timeout_cycles.load_next) begin
                field_storage.EFUSE_READ_REQ_TIMEOUT.read_req_timeout_cycles.value <= field_combo.EFUSE_READ_REQ_TIMEOUT.read_req_timeout_cycles.next;
            end
        end
    end
    assign hwif_out.EFUSE_READ_REQ_TIMEOUT.read_req_timeout_cycles.value = field_storage.EFUSE_READ_REQ_TIMEOUT.read_req_timeout_cycles.value;
    // Field: efuse_interface_ctrl.EFUSE_READ_REQ_TIMEOUT.read_req_timout_enable
    always_comb begin
        automatic logic [0:0] next_c;
        automatic logic load_next_c;
        next_c = field_storage.EFUSE_READ_REQ_TIMEOUT.read_req_timout_enable.value;
        load_next_c = '0;
        if(decoded_reg_strb.EFUSE_READ_REQ_TIMEOUT && decoded_req_is_wr) begin // SW write
            next_c = (field_storage.EFUSE_READ_REQ_TIMEOUT.read_req_timout_enable.value & ~decoded_wr_biten[28:28]) | (decoded_wr_data[28:28] & decoded_wr_biten[28:28]);
            load_next_c = '1;
        end
        field_combo.EFUSE_READ_REQ_TIMEOUT.read_req_timout_enable.next = next_c;
        field_combo.EFUSE_READ_REQ_TIMEOUT.read_req_timout_enable.load_next = load_next_c;
    end
    always_ff @(posedge clk or negedge arst_n) begin
        if(~arst_n) begin
            field_storage.EFUSE_READ_REQ_TIMEOUT.read_req_timout_enable.value <= 1'h0;
        end else begin
            if(field_combo.EFUSE_READ_REQ_TIMEOUT.read_req_timout_enable.load_next) begin
                field_storage.EFUSE_READ_REQ_TIMEOUT.read_req_timout_enable.value <= field_combo.EFUSE_READ_REQ_TIMEOUT.read_req_timout_enable.next;
            end
        end
    end
    assign hwif_out.EFUSE_READ_REQ_TIMEOUT.read_req_timout_enable.value = field_storage.EFUSE_READ_REQ_TIMEOUT.read_req_timout_enable.value;
    // Field: efuse_interface_ctrl.EFUSE_PROGRAM_REQ_TIMEOUT.program_req_timeout_cycles
    always_comb begin
        automatic logic [27:0] next_c;
        automatic logic load_next_c;
        next_c = field_storage.EFUSE_PROGRAM_REQ_TIMEOUT.program_req_timeout_cycles.value;
        load_next_c = '0;
        if(decoded_reg_strb.EFUSE_PROGRAM_REQ_TIMEOUT && decoded_req_is_wr) begin // SW write
            next_c = (field_storage.EFUSE_PROGRAM_REQ_TIMEOUT.program_req_timeout_cycles.value & ~decoded_wr_biten[27:0]) | (decoded_wr_data[27:0] & decoded_wr_biten[27:0]);
            load_next_c = '1;
        end
        field_combo.EFUSE_PROGRAM_REQ_TIMEOUT.program_req_timeout_cycles.next = next_c;
        field_combo.EFUSE_PROGRAM_REQ_TIMEOUT.program_req_timeout_cycles.load_next = load_next_c;
    end
    always_ff @(posedge clk or negedge arst_n) begin
        if(~arst_n) begin
            field_storage.EFUSE_PROGRAM_REQ_TIMEOUT.program_req_timeout_cycles.value <= 28'h800000;
        end else begin
            if(field_combo.EFUSE_PROGRAM_REQ_TIMEOUT.program_req_timeout_cycles.load_next) begin
                field_storage.EFUSE_PROGRAM_REQ_TIMEOUT.program_req_timeout_cycles.value <= field_combo.EFUSE_PROGRAM_REQ_TIMEOUT.program_req_timeout_cycles.next;
            end
        end
    end
    assign hwif_out.EFUSE_PROGRAM_REQ_TIMEOUT.program_req_timeout_cycles.value = field_storage.EFUSE_PROGRAM_REQ_TIMEOUT.program_req_timeout_cycles.value;
    // Field: efuse_interface_ctrl.EFUSE_PROGRAM_REQ_TIMEOUT.program_req_timeout_enable
    always_comb begin
        automatic logic [0:0] next_c;
        automatic logic load_next_c;
        next_c = field_storage.EFUSE_PROGRAM_REQ_TIMEOUT.program_req_timeout_enable.value;
        load_next_c = '0;
        if(decoded_reg_strb.EFUSE_PROGRAM_REQ_TIMEOUT && decoded_req_is_wr) begin // SW write
            next_c = (field_storage.EFUSE_PROGRAM_REQ_TIMEOUT.program_req_timeout_enable.value & ~decoded_wr_biten[28:28]) | (decoded_wr_data[28:28] & decoded_wr_biten[28:28]);
            load_next_c = '1;
        end
        field_combo.EFUSE_PROGRAM_REQ_TIMEOUT.program_req_timeout_enable.next = next_c;
        field_combo.EFUSE_PROGRAM_REQ_TIMEOUT.program_req_timeout_enable.load_next = load_next_c;
    end
    always_ff @(posedge clk or negedge arst_n) begin
        if(~arst_n) begin
            field_storage.EFUSE_PROGRAM_REQ_TIMEOUT.program_req_timeout_enable.value <= 1'h0;
        end else begin
            if(field_combo.EFUSE_PROGRAM_REQ_TIMEOUT.program_req_timeout_enable.load_next) begin
                field_storage.EFUSE_PROGRAM_REQ_TIMEOUT.program_req_timeout_enable.value <= field_combo.EFUSE_PROGRAM_REQ_TIMEOUT.program_req_timeout_enable.next;
            end
        end
    end
    assign hwif_out.EFUSE_PROGRAM_REQ_TIMEOUT.program_req_timeout_enable.value = field_storage.EFUSE_PROGRAM_REQ_TIMEOUT.program_req_timeout_enable.value;

    //--------------------------------------------------------------------------
    // Write response
    //--------------------------------------------------------------------------
    assign cpuif_wr_ack = decoded_req & decoded_req_is_wr;
    // Writes are always granted with no error response
    assign cpuif_wr_err = '0;

    //--------------------------------------------------------------------------
    // Readback
    //--------------------------------------------------------------------------

    logic readback_err;
    logic readback_done;
    logic [31:0] readback_data;

    // Assign readback values to a flattened array
    logic [31:0] readback_array[7];
    assign readback_array[0][0:0] = (decoded_reg_strb.EFUSE_INTERFACE_CTRL_STATUS && !decoded_req_is_wr) ? hwif_in.EFUSE_INTERFACE_CTRL_STATUS.efuse_sense_done.next : '0;
    assign readback_array[0][3:1] = '0;
    assign readback_array[0][4:4] = (decoded_reg_strb.EFUSE_INTERFACE_CTRL_STATUS && !decoded_req_is_wr) ? hwif_in.EFUSE_INTERFACE_CTRL_STATUS.efuse_req_error.next : '0;
    assign readback_array[0][31:5] = '0;
    assign readback_array[1][15:0] = (decoded_reg_strb.EFUSE_WRITE_CTRL && !decoded_req_is_wr) ? field_storage.EFUSE_WRITE_CTRL.efuse_addr.value : '0;
    assign readback_array[1][16:16] = (decoded_reg_strb.EFUSE_WRITE_CTRL && !decoded_req_is_wr) ? field_storage.EFUSE_WRITE_CTRL.efuse_data.value : '0;
    assign readback_array[1][17:17] = (decoded_reg_strb.EFUSE_WRITE_CTRL && !decoded_req_is_wr) ? field_storage.EFUSE_WRITE_CTRL.efuse_write_go.value : '0;
    assign readback_array[1][18:18] = (decoded_reg_strb.EFUSE_WRITE_CTRL && !decoded_req_is_wr) ? field_storage.EFUSE_WRITE_CTRL.efuse_program_read_back.value : '0;
    assign readback_array[1][23:19] = '0;
    assign readback_array[1][24:24] = (decoded_reg_strb.EFUSE_WRITE_CTRL && !decoded_req_is_wr) ? hwif_in.EFUSE_WRITE_CTRL.write_busy.next : '0;
    assign readback_array[1][25:25] = (decoded_reg_strb.EFUSE_WRITE_CTRL && !decoded_req_is_wr) ? hwif_in.EFUSE_WRITE_CTRL.write_done.next : '0;
    assign readback_array[1][26:26] = (decoded_reg_strb.EFUSE_WRITE_CTRL && !decoded_req_is_wr) ? hwif_in.EFUSE_WRITE_CTRL.write_status.next : '0;
    assign readback_array[1][27:27] = (decoded_reg_strb.EFUSE_WRITE_CTRL && !decoded_req_is_wr) ? field_storage.EFUSE_WRITE_CTRL.program_enable.value : '0;
    assign readback_array[1][31:28] = '0;
    assign readback_array[2][15:0] = (decoded_reg_strb.EFUSE_READ_CTRL && !decoded_req_is_wr) ? field_storage.EFUSE_READ_CTRL.efuse_addr.value : '0;
    assign readback_array[2][16:16] = (decoded_reg_strb.EFUSE_READ_CTRL && !decoded_req_is_wr) ? field_storage.EFUSE_READ_CTRL.efuse_read_go.value : '0;
    assign readback_array[2][23:17] = '0;
    assign readback_array[2][24:24] = (decoded_reg_strb.EFUSE_READ_CTRL && !decoded_req_is_wr) ? hwif_in.EFUSE_READ_CTRL.read_busy.next : '0;
    assign readback_array[2][25:25] = (decoded_reg_strb.EFUSE_READ_CTRL && !decoded_req_is_wr) ? hwif_in.EFUSE_READ_CTRL.read_done.next : '0;
    assign readback_array[2][26:26] = (decoded_reg_strb.EFUSE_READ_CTRL && !decoded_req_is_wr) ? hwif_in.EFUSE_READ_CTRL.read_status.next : '0;
    assign readback_array[2][27:27] = '0;
    assign readback_array[2][28:28] = (decoded_reg_strb.EFUSE_READ_CTRL && !decoded_req_is_wr) ? field_storage.EFUSE_READ_CTRL.read_enable.value : '0;
    assign readback_array[2][31:29] = '0;
    assign readback_array[3][31:0] = (decoded_reg_strb.EFUSE_PROGRAM_INTERFACE_READ_DATA && !decoded_req_is_wr) ? hwif_in.EFUSE_PROGRAM_INTERFACE_READ_DATA.dout.next : '0;
    assign readback_array[4][31:0] = (decoded_reg_strb.EFUSE_READ_INTERFACE_READ_DATA && !decoded_req_is_wr) ? hwif_in.EFUSE_READ_INTERFACE_READ_DATA.dout.next : '0;
    assign readback_array[5][27:0] = (decoded_reg_strb.EFUSE_READ_REQ_TIMEOUT && !decoded_req_is_wr) ? field_storage.EFUSE_READ_REQ_TIMEOUT.read_req_timeout_cycles.value : '0;
    assign readback_array[5][28:28] = (decoded_reg_strb.EFUSE_READ_REQ_TIMEOUT && !decoded_req_is_wr) ? field_storage.EFUSE_READ_REQ_TIMEOUT.read_req_timout_enable.value : '0;
    assign readback_array[5][31:29] = '0;
    assign readback_array[6][27:0] = (decoded_reg_strb.EFUSE_PROGRAM_REQ_TIMEOUT && !decoded_req_is_wr) ? field_storage.EFUSE_PROGRAM_REQ_TIMEOUT.program_req_timeout_cycles.value : '0;
    assign readback_array[6][28:28] = (decoded_reg_strb.EFUSE_PROGRAM_REQ_TIMEOUT && !decoded_req_is_wr) ? field_storage.EFUSE_PROGRAM_REQ_TIMEOUT.program_req_timeout_enable.value : '0;
    assign readback_array[6][31:29] = '0;

    // Reduce the array
    always_comb begin
        automatic logic [31:0] readback_data_var;
        readback_done = decoded_req & ~decoded_req_is_wr;
        readback_err = '0;
        readback_data_var = '0;
        for(int i=0; i<7; i++) readback_data_var |= readback_array[i];
        readback_data = readback_data_var;
    end

    assign cpuif_rd_ack = readback_done;
    assign cpuif_rd_data = readback_data;
    assign cpuif_rd_err = readback_err;
endmodule
