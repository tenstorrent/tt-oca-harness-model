// Generated by PeakRDL-regblock - A free and open-source SystemVerilog generator
//  https://github.com/SystemRDL/PeakRDL-regblock

module km_kpv_kpvlp_reg (
        input wire clk,
        input wire arst_n,

        output logic s_axil_awready,
        input wire s_axil_awvalid,
        input wire [11:0] s_axil_awaddr,
        input wire [2:0] s_axil_awprot,
        output logic s_axil_wready,
        input wire s_axil_wvalid,
        input wire [31:0] s_axil_wdata,
        input wire [3:0]s_axil_wstrb,
        input wire s_axil_bready,
        output logic s_axil_bvalid,
        output logic [1:0] s_axil_bresp,
        output logic s_axil_arready,
        input wire s_axil_arvalid,
        input wire [11:0] s_axil_araddr,
        input wire [2:0] s_axil_arprot,
        input wire s_axil_rready,
        output logic s_axil_rvalid,
        output logic [31:0] s_axil_rdata,
        output logic [1:0] s_axil_rresp,

        input km_kpv_kpvlp_reg_pkg::km_kpv_kpvlp__in_t hwif_in,
        output km_kpv_kpvlp_reg_pkg::km_kpv_kpvlp__out_t hwif_out
    );

    //--------------------------------------------------------------------------
    // CPU Bus interface logic
    //--------------------------------------------------------------------------
    logic cpuif_req;
    logic cpuif_req_is_wr;
    logic [11:0] cpuif_addr;
    logic [31:0] cpuif_wr_data;
    logic [31:0] cpuif_wr_biten;
    logic cpuif_req_stall_wr;
    logic cpuif_req_stall_rd;

    logic cpuif_rd_ack;
    logic cpuif_rd_err;
    logic [31:0] cpuif_rd_data;

    logic cpuif_wr_ack;
    logic cpuif_wr_err;

    // Max Outstanding Transactions: 2
    logic [1:0] axil_n_in_flight;
    logic axil_prev_was_rd;
    logic axil_arvalid;
    logic [11:0] axil_araddr;
    logic axil_ar_accept;
    logic axil_awvalid;
    logic [11:0] axil_awaddr;
    logic axil_wvalid;
    logic [31:0] axil_wdata;
    logic [3:0] axil_wstrb;
    logic axil_aw_accept;
    logic axil_resp_acked;

    // Transaction request acceptance
    always_ff @(posedge clk or negedge arst_n) begin
        if(~arst_n) begin
            axil_prev_was_rd <= '0;
            axil_arvalid <= '0;
            axil_araddr <= '0;
            axil_awvalid <= '0;
            axil_awaddr <= '0;
            axil_wvalid <= '0;
            axil_wdata <= '0;
            axil_wstrb <= '0;
            axil_n_in_flight <= '0;
        end else begin
            // AR* acceptance register
            if(axil_ar_accept) begin
                axil_prev_was_rd <= '1;
                axil_arvalid <= '0;
            end
            if(s_axil_arvalid && s_axil_arready) begin
                axil_arvalid <= '1;
                axil_araddr <= s_axil_araddr;
            end

            // AW* & W* acceptance registers
            if(axil_aw_accept) begin
                axil_prev_was_rd <= '0;
                axil_awvalid <= '0;
                axil_wvalid <= '0;
            end
            if(s_axil_awvalid && s_axil_awready) begin
                axil_awvalid <= '1;
                axil_awaddr <= s_axil_awaddr;
            end
            if(s_axil_wvalid && s_axil_wready) begin
                axil_wvalid <= '1;
                axil_wdata <= s_axil_wdata;
                axil_wstrb <= s_axil_wstrb;
            end

            // Keep track of in-flight transactions
            if((axil_ar_accept || axil_aw_accept) && !axil_resp_acked) begin
                axil_n_in_flight <= axil_n_in_flight + 1'b1;
            end else if(!(axil_ar_accept || axil_aw_accept) && axil_resp_acked) begin
                axil_n_in_flight <= axil_n_in_flight - 1'b1;
            end
        end
    end

    always_comb begin
        s_axil_arready = (!axil_arvalid || axil_ar_accept);
        s_axil_awready = (!axil_awvalid || axil_aw_accept);
        s_axil_wready = (!axil_wvalid || axil_aw_accept);
    end

    // Request dispatch
    always_comb begin
        cpuif_wr_data = axil_wdata;
        for(int i=0; i<4; i++) begin
            cpuif_wr_biten[i*8 +: 8] = {8{axil_wstrb[i]}};
        end
        cpuif_req = '0;
        cpuif_req_is_wr = '0;
        cpuif_addr = '0;
        axil_ar_accept = '0;
        axil_aw_accept = '0;

        if(axil_n_in_flight < 2'd2) begin
            // Can safely issue more transactions without overwhelming response buffer
            if(axil_arvalid && !axil_prev_was_rd) begin
                cpuif_req = '1;
                cpuif_req_is_wr = '0;
                cpuif_addr = {axil_araddr[11:2], 2'b0};
                if(!cpuif_req_stall_rd) axil_ar_accept = '1;
            end else if(axil_awvalid && axil_wvalid) begin
                cpuif_req = '1;
                cpuif_req_is_wr = '1;
                cpuif_addr = {axil_awaddr[11:2], 2'b0};
                if(!cpuif_req_stall_wr) axil_aw_accept = '1;
            end else if(axil_arvalid) begin
                cpuif_req = '1;
                cpuif_req_is_wr = '0;
                cpuif_addr = {axil_araddr[11:2], 2'b0};
                if(!cpuif_req_stall_rd) axil_ar_accept = '1;
            end
        end
    end


    // AXI4-Lite Response Logic
    struct {
        logic is_wr;
        logic err;
        logic [31:0] rdata;
    } axil_resp_buffer[2];

    logic [1:0] axil_resp_wptr;
    logic [1:0] axil_resp_rptr;

    always_ff @(posedge clk or negedge arst_n) begin
        if(~arst_n) begin
            for(int i=0; i<2; i++) begin
                axil_resp_buffer[i].is_wr <= '0;
                axil_resp_buffer[i].err <= '0;
                axil_resp_buffer[i].rdata <= '0;
            end
            axil_resp_wptr <= '0;
            axil_resp_rptr <= '0;
        end else begin
            // Store responses in buffer until AXI response channel accepts them
            if(cpuif_rd_ack || cpuif_wr_ack) begin
                if(cpuif_rd_ack) begin
                    axil_resp_buffer[axil_resp_wptr[0:0]].is_wr <= '0;
                    axil_resp_buffer[axil_resp_wptr[0:0]].err <= cpuif_rd_err;
                    axil_resp_buffer[axil_resp_wptr[0:0]].rdata <= cpuif_rd_data;

                end else if(cpuif_wr_ack) begin
                    axil_resp_buffer[axil_resp_wptr[0:0]].is_wr <= '1;
                    axil_resp_buffer[axil_resp_wptr[0:0]].err <= cpuif_wr_err;
                end
                axil_resp_wptr <= axil_resp_wptr + 1'b1;
            end

            // Advance read pointer when acknowledged
            if(axil_resp_acked) begin
                axil_resp_rptr <= axil_resp_rptr + 1'b1;
            end
        end
    end

    always_comb begin
        axil_resp_acked = '0;
        s_axil_bvalid = '0;
        s_axil_rvalid = '0;
        if(axil_resp_rptr != axil_resp_wptr) begin
            if(axil_resp_buffer[axil_resp_rptr[0:0]].is_wr) begin
                s_axil_bvalid = '1;
                if(s_axil_bready) axil_resp_acked = '1;
            end else begin
                s_axil_rvalid = '1;
                if(s_axil_rready) axil_resp_acked = '1;
            end
        end

        s_axil_rdata = axil_resp_buffer[axil_resp_rptr[0:0]].rdata;
        if(axil_resp_buffer[axil_resp_rptr[0:0]].err) begin
            s_axil_bresp = 2'b10;
            s_axil_rresp = 2'b10;
        end else begin
            s_axil_bresp = 2'b00;
            s_axil_rresp = 2'b00;
        end
    end

    logic cpuif_req_masked;
    logic external_req;
    logic external_pending;
    logic external_wr_ack;
    logic external_rd_ack;
    always_ff @(posedge clk or negedge arst_n) begin
        if(~arst_n) begin
            external_pending <= '0;
        end else begin
            if(external_req & ~external_wr_ack & ~external_rd_ack) external_pending <= '1;
            else if(external_wr_ack | external_rd_ack) external_pending <= '0;
            `ifndef SYNTHESIS
                assert_bad_ext_wr_ack: assert(!external_wr_ack || (external_pending | external_req))
                    else $error("An external wr_ack strobe was asserted when no external request was active");
                assert_bad_ext_rd_ack: assert(!external_rd_ack || (external_pending | external_req))
                    else $error("An external rd_ack strobe was asserted when no external request was active");
            `endif
        end
    end

    // Read & write latencies are balanced. Stalls not required
    // except if external
    assign cpuif_req_stall_rd = external_pending;
    assign cpuif_req_stall_wr = external_pending;
    assign cpuif_req_masked = cpuif_req
                            & !(!cpuif_req_is_wr & cpuif_req_stall_rd)
                            & !(cpuif_req_is_wr & cpuif_req_stall_wr);

    //--------------------------------------------------------------------------
    // Address Decode
    //--------------------------------------------------------------------------
    typedef struct {
        logic KPVLP_KEY_ENTRY[32];
        logic KPVLP_CTRL[32];
        logic KPVLP_STATUS;
    } decoded_reg_strb_t;
    decoded_reg_strb_t decoded_reg_strb;
    logic decoded_err;
    logic decoded_strb_is_external;

    logic [11:0] decoded_addr;

    logic decoded_req;
    logic decoded_req_is_wr;
    logic [31:0] decoded_wr_data;
    logic [31:0] decoded_wr_biten;

    always_comb begin
        automatic logic is_valid_addr;
        automatic logic is_invalid_rw;
        automatic logic is_external;
        is_external = '0;
        is_valid_addr = '0;
        is_invalid_rw = '0;
        for(int i0=0; i0<32; i0++) begin
            decoded_reg_strb.KPVLP_KEY_ENTRY[i0] = cpuif_req_masked & (cpuif_addr >= 12'h0 + (12)'(i0) * 12'h40) & (cpuif_addr <= 12'h0 + (12)'(i0) * 12'h40 + 12'h3f);
            is_external |= cpuif_req_masked & (cpuif_addr >= 12'h0 + (12)'(i0) * 12'h40) & (cpuif_addr <= 12'h0 + (12)'(i0) * 12'h40 + 12'h3f);
            is_valid_addr |= cpuif_req_masked & (cpuif_addr >= 12'h0 + (12)'(i0) * 12'h40) & (cpuif_addr <= 12'h0 + (12)'(i0) * 12'h40 + 12'h3f);
        end
        for(int i0=0; i0<32; i0++) begin
            decoded_reg_strb.KPVLP_CTRL[i0] = cpuif_req_masked & (cpuif_addr == 12'h800 + (12)'(i0) * 12'h4) & cpuif_req_is_wr;
            is_valid_addr |= cpuif_req_masked & (cpuif_addr == 12'h800 + (12)'(i0) * 12'h4);
            is_invalid_rw |= cpuif_req_masked & (cpuif_addr == 12'h800 + (12)'(i0) * 12'h4) & !cpuif_req_is_wr;
        end
        decoded_reg_strb.KPVLP_STATUS = cpuif_req_masked & (cpuif_addr == 12'h880) & !cpuif_req_is_wr;
        is_valid_addr |= cpuif_req_masked & (cpuif_addr == 12'h880);
        is_invalid_rw |= cpuif_req_masked & (cpuif_addr == 12'h880) & cpuif_req_is_wr;
        decoded_err = (~is_valid_addr | is_invalid_rw) & decoded_req;
        decoded_strb_is_external = is_external;
        external_req = is_external;
    end

    // Pass down signals to next stage
    assign decoded_addr = cpuif_addr;

    assign decoded_req = cpuif_req_masked;
    assign decoded_req_is_wr = cpuif_req_is_wr;
    assign decoded_wr_data = cpuif_wr_data;
    assign decoded_wr_biten = cpuif_wr_biten;

    //--------------------------------------------------------------------------
    // Field logic
    //--------------------------------------------------------------------------
    typedef struct {
        struct {
            struct {
                logic [2:0] next;
                logic load_next;
            } extend;
            struct {
                logic [1:0] next;
                logic load_next;
            } rsvd_8_7;
            struct {
                logic [7:0] next;
                logic load_next;
            } dest_valid;
            struct {
                logic [3:0] next;
                logic load_next;
            } last_dword;
            struct {
                logic [10:0] next;
                logic load_next;
            } rsvd_31_21;
        } KPVLP_CTRL[32];
    } field_combo_t;
    field_combo_t field_combo;

    typedef struct {
        struct {
            struct {
                logic [2:0] value;
            } extend;
            struct {
                logic [1:0] value;
            } rsvd_8_7;
            struct {
                logic [7:0] value;
            } dest_valid;
            struct {
                logic [3:0] value;
            } last_dword;
            struct {
                logic [10:0] value;
            } rsvd_31_21;
        } KPVLP_CTRL[32];
    } field_storage_t;
    field_storage_t field_storage;

    for(genvar i0=0; i0<32; i0++) begin
        // External region: km_kpv_kpvlp.KPVLP_KEY_ENTRY[]
        assign hwif_out.KPVLP_KEY_ENTRY[i0].req = decoded_reg_strb.KPVLP_KEY_ENTRY[i0];
        assign hwif_out.KPVLP_KEY_ENTRY[i0].addr = decoded_addr[5:0];
        assign hwif_out.KPVLP_KEY_ENTRY[i0].req_is_wr = decoded_req_is_wr;
        assign hwif_out.KPVLP_KEY_ENTRY[i0].wr_data = decoded_wr_data;
        assign hwif_out.KPVLP_KEY_ENTRY[i0].wr_biten = decoded_wr_biten;
    end
    for(genvar i0=0; i0<32; i0++) begin
        // Field: km_kpv_kpvlp.KPVLP_CTRL[].extend
        always_comb begin
            automatic logic [2:0] next_c;
            automatic logic load_next_c;
            next_c = field_storage.KPVLP_CTRL[i0].extend.value;
            load_next_c = '0;
            if(decoded_reg_strb.KPVLP_CTRL[i0] && decoded_req_is_wr) begin // SW write
                next_c = (field_storage.KPVLP_CTRL[i0].extend.value & ~decoded_wr_biten[6:4]) | (decoded_wr_data[6:4] & decoded_wr_biten[6:4]);
                load_next_c = '1;
            end else begin // HW Write
                next_c = hwif_in.KPVLP_CTRL[i0].extend.next;
                load_next_c = '1;
            end
            field_combo.KPVLP_CTRL[i0].extend.next = next_c;
            field_combo.KPVLP_CTRL[i0].extend.load_next = load_next_c;
        end
        always_ff @(posedge clk or negedge arst_n) begin
            if(~arst_n) begin
                field_storage.KPVLP_CTRL[i0].extend.value <= 3'h0;
            end else begin
                if(field_combo.KPVLP_CTRL[i0].extend.load_next) begin
                    field_storage.KPVLP_CTRL[i0].extend.value <= field_combo.KPVLP_CTRL[i0].extend.next;
                end
            end
        end
        assign hwif_out.KPVLP_CTRL[i0].extend.value = field_storage.KPVLP_CTRL[i0].extend.value;
        // Field: km_kpv_kpvlp.KPVLP_CTRL[].rsvd_8_7
        always_comb begin
            automatic logic [1:0] next_c;
            automatic logic load_next_c;
            next_c = field_storage.KPVLP_CTRL[i0].rsvd_8_7.value;
            load_next_c = '0;
            if(decoded_reg_strb.KPVLP_CTRL[i0] && decoded_req_is_wr) begin // SW write
                next_c = (field_storage.KPVLP_CTRL[i0].rsvd_8_7.value & ~decoded_wr_biten[8:7]) | (decoded_wr_data[8:7] & decoded_wr_biten[8:7]);
                load_next_c = '1;
            end
            field_combo.KPVLP_CTRL[i0].rsvd_8_7.next = next_c;
            field_combo.KPVLP_CTRL[i0].rsvd_8_7.load_next = load_next_c;
        end
        always_ff @(posedge clk or negedge arst_n) begin
            if(~arst_n) begin
                field_storage.KPVLP_CTRL[i0].rsvd_8_7.value <= 2'h0;
            end else begin
                if(field_combo.KPVLP_CTRL[i0].rsvd_8_7.load_next) begin
                    field_storage.KPVLP_CTRL[i0].rsvd_8_7.value <= field_combo.KPVLP_CTRL[i0].rsvd_8_7.next;
                end
            end
        end
        // Field: km_kpv_kpvlp.KPVLP_CTRL[].dest_valid
        always_comb begin
            automatic logic [7:0] next_c;
            automatic logic load_next_c;
            next_c = field_storage.KPVLP_CTRL[i0].dest_valid.value;
            load_next_c = '0;
            if(decoded_reg_strb.KPVLP_CTRL[i0] && decoded_req_is_wr) begin // SW write
                next_c = (field_storage.KPVLP_CTRL[i0].dest_valid.value & ~decoded_wr_biten[16:9]) | (decoded_wr_data[16:9] & decoded_wr_biten[16:9]);
                load_next_c = '1;
            end else begin // HW Write
                next_c = hwif_in.KPVLP_CTRL[i0].dest_valid.next;
                load_next_c = '1;
            end
            field_combo.KPVLP_CTRL[i0].dest_valid.next = next_c;
            field_combo.KPVLP_CTRL[i0].dest_valid.load_next = load_next_c;
        end
        always_ff @(posedge clk or negedge arst_n) begin
            if(~arst_n) begin
                field_storage.KPVLP_CTRL[i0].dest_valid.value <= 8'h0;
            end else begin
                if(field_combo.KPVLP_CTRL[i0].dest_valid.load_next) begin
                    field_storage.KPVLP_CTRL[i0].dest_valid.value <= field_combo.KPVLP_CTRL[i0].dest_valid.next;
                end
            end
        end
        assign hwif_out.KPVLP_CTRL[i0].dest_valid.value = field_storage.KPVLP_CTRL[i0].dest_valid.value;
        // Field: km_kpv_kpvlp.KPVLP_CTRL[].last_dword
        always_comb begin
            automatic logic [3:0] next_c;
            automatic logic load_next_c;
            next_c = field_storage.KPVLP_CTRL[i0].last_dword.value;
            load_next_c = '0;
            if(decoded_reg_strb.KPVLP_CTRL[i0] && decoded_req_is_wr) begin // SW write
                next_c = (field_storage.KPVLP_CTRL[i0].last_dword.value & ~decoded_wr_biten[20:17]) | (decoded_wr_data[20:17] & decoded_wr_biten[20:17]);
                load_next_c = '1;
            end else begin // HW Write
                next_c = hwif_in.KPVLP_CTRL[i0].last_dword.next;
                load_next_c = '1;
            end
            field_combo.KPVLP_CTRL[i0].last_dword.next = next_c;
            field_combo.KPVLP_CTRL[i0].last_dword.load_next = load_next_c;
        end
        always_ff @(posedge clk or negedge arst_n) begin
            if(~arst_n) begin
                field_storage.KPVLP_CTRL[i0].last_dword.value <= 4'h0;
            end else begin
                if(field_combo.KPVLP_CTRL[i0].last_dword.load_next) begin
                    field_storage.KPVLP_CTRL[i0].last_dword.value <= field_combo.KPVLP_CTRL[i0].last_dword.next;
                end
            end
        end
        assign hwif_out.KPVLP_CTRL[i0].last_dword.value = field_storage.KPVLP_CTRL[i0].last_dword.value;
        // Field: km_kpv_kpvlp.KPVLP_CTRL[].rsvd_31_21
        always_comb begin
            automatic logic [10:0] next_c;
            automatic logic load_next_c;
            next_c = field_storage.KPVLP_CTRL[i0].rsvd_31_21.value;
            load_next_c = '0;
            if(decoded_reg_strb.KPVLP_CTRL[i0] && decoded_req_is_wr) begin // SW write
                next_c = (field_storage.KPVLP_CTRL[i0].rsvd_31_21.value & ~decoded_wr_biten[31:21]) | (decoded_wr_data[31:21] & decoded_wr_biten[31:21]);
                load_next_c = '1;
            end
            field_combo.KPVLP_CTRL[i0].rsvd_31_21.next = next_c;
            field_combo.KPVLP_CTRL[i0].rsvd_31_21.load_next = load_next_c;
        end
        always_ff @(posedge clk or negedge arst_n) begin
            if(~arst_n) begin
                field_storage.KPVLP_CTRL[i0].rsvd_31_21.value <= 11'h0;
            end else begin
                if(field_combo.KPVLP_CTRL[i0].rsvd_31_21.load_next) begin
                    field_storage.KPVLP_CTRL[i0].rsvd_31_21.value <= field_combo.KPVLP_CTRL[i0].rsvd_31_21.next;
                end
            end
        end
    end

    //--------------------------------------------------------------------------
    // Write response
    //--------------------------------------------------------------------------
    always_comb begin
        automatic logic wr_ack;
        wr_ack = '0;
        for(int i0=0; i0<32; i0++) begin
            wr_ack |= hwif_in.KPVLP_KEY_ENTRY[i0].wr_ack;
        end
        external_wr_ack = wr_ack;
    end
    assign cpuif_wr_ack = external_wr_ack | (decoded_req & decoded_req_is_wr & ~decoded_strb_is_external);
    // Writes are always granted with no error response
    assign cpuif_wr_err = decoded_err;

    //--------------------------------------------------------------------------
    // Readback
    //--------------------------------------------------------------------------
    logic readback_external_rd_ack_c;
    always_comb begin
        automatic logic rd_ack;
        rd_ack = '0;
        for(int i0=0; i0<32; i0++) begin
            rd_ack |= hwif_in.KPVLP_KEY_ENTRY[i0].rd_ack;
        end
        readback_external_rd_ack_c = rd_ack;
    end

    logic readback_external_rd_ack;

    assign readback_external_rd_ack = readback_external_rd_ack_c;

    logic readback_err;
    logic readback_done;
    logic [31:0] readback_data;

    // Assign readback values to a flattened array
    logic [31:0] readback_array[33];
    for(genvar i0=0; i0<32; i0++) begin
        assign readback_array[i0 * 1 + 0] = hwif_in.KPVLP_KEY_ENTRY[i0].rd_ack ? hwif_in.KPVLP_KEY_ENTRY[i0].rd_data : '0;
    end
    assign readback_array[32][31:0] = (decoded_reg_strb.KPVLP_STATUS && !decoded_req_is_wr) ? hwif_in.KPVLP_STATUS.unlock_sep.next : '0;

    // Reduce the array
    always_comb begin
        automatic logic [31:0] readback_data_var;
        readback_done = decoded_req & ~decoded_req_is_wr & ~decoded_strb_is_external;
        readback_err = decoded_err;
        readback_data_var = '0;
        for(int i=0; i<33; i++) readback_data_var |= readback_array[i];
        readback_data = readback_data_var;
    end

    assign external_rd_ack = readback_external_rd_ack;
    assign cpuif_rd_ack = readback_done | readback_external_rd_ack;
    assign cpuif_rd_data = readback_data;
    assign cpuif_rd_err = readback_err;
endmodule
