/*
 * This Synopsys software and associated documentation (hereinafter the
 * "Software") is an unsupported proprietary work of Synopsys, Inc. unless
 * otherwise expressly agreed to in writing between Synopsys and you. The
 * Software IS NOT an item of Licensed Software or a Licensed Product under
 * any End User Software License Agreement or Agreement for Licensed Products
 * with Synopsys or any supplement thereto. Synopsys is a registered trademark
 * of Synopsys, Inc. Other names included in the SOFTWARE may be the
 * trademarks of their respective owners.
 *
 * The contents of this file are dual-licensed; you may select either version
 * 2 of the GNU General Public License ("GPL") or the BSD-3-Clause license
 * ("BSD-3-Clause"). The GPL is included in the COPYING file accompanying the
 * SOFTWARE. The BSD License is copied below.
 *
 * BSD-3-Clause License:
 * Copyright (c) 2011-2020, 2022 Synopsys, Inc. and/or its affiliates.
 * Redistribution and use in source and binary forms, with or without
 * modification, are permitted provided that the following conditions are met:
 *
 * 1. Redistributions of source code must retain the above copyright notice,
 *    this list of conditions, and the following disclaimer, without
 *    modification.
 *
 * 2. Redistributions in binary form must reproduce the above copyright
 *    notice, this list of conditions and the following disclaimer in the
 *    documentation and/or other materials provided with the distribution.
 *
 * 3. The names of the above-listed copyright holders may not be used to
 *    endorse or promote products derived from this software without specific
 *    prior written permission.
 *
 * THIS SOFTWARE IS PROVIDED BY THE COPYRIGHT HOLDERS AND CONTRIBUTORS "AS IS"
 * AND ANY EXPRESS OR IMPLIED WARRANTIES, INCLUDING, BUT NOT LIMITED TO, THE
 * IMPLIED WARRANTIES OF MERCHANTABILITY AND FITNESS FOR A PARTICULAR PURPOSE
 * ARE DISCLAIMED. IN NO EVENT SHALL THE COPYRIGHT HOLDER OR CONTRIBUTORS BE
 * LIABLE FOR ANY DIRECT, INDIRECT, INCIDENTAL, SPECIAL, EXEMPLARY, OR
 * CONSEQUENTIAL DAMAGES (INCLUDING, BUT NOT LIMITED TO, PROCUREMENT OF
 * SUBSTITUTE GOODS OR SERVICES; LOSS OF USE, DATA, OR PROFITS; OR BUSINESS
 * INTERRUPTION) HOWEVER CAUSED AND ON ANY THEORY OF LIABILITY, WHETHER IN
 * CONTRACT, STRICT LIABILITY, OR TORT (INCLUDING NEGLIGENCE OR OTHERWISE)
 * ARISING IN ANY WAY OUT OF THE USE OF THIS SOFTWARE, EVEN IF ADVISED OF THE
 * POSSIBILITY OF SUCH DAMAGE.
 */

/**
 * \addtogroup SampleApps
 * @{
 *
 * \defgroup rsa_encrypt_decrypt  rsa_encrypt_decrypt.c
 *
 *
 * \code
 */

#include <stdio.h>
#include <stdlib.h>
#include <inttypes.h>
#include <string.h>
#include <errno.h>

#include "pka.h"
#include "ram_fw.h"

#define PKA_BASE_ADDRESS 0

#define ALLOC_MEMBLOCK(mem_ptr, size)            (mem_ptr =  malloc(size))
#define RSA_MOD_M(mem_ptr, buf, key_size)        (buf =      mem_ptr + (key_size * 0))
#define RSA_MOD_RSQR(mem_ptr, buf, key_size)     (buf =      mem_ptr + (key_size * 1))
#define RSA_MOD_MP(mem_ptr, buf, key_size)       (buf =      mem_ptr + (key_size * 2))
#define RSA_KEY_EXP(mem_ptr, buf, key_size)      (buf =      mem_ptr + (key_size * 3))
#define RSA_CT(mem_ptr, buf, key_size)           (buf =      mem_ptr + (key_size * 4))
#define RSA_MSGDECRYPT(mem_ptr, buf, key_size)   (buf =      mem_ptr + (key_size * 5))

#define MEM_BLOCK_SIZE(key_size)    ((key_size * 6))

// RSA_PKCS1_V15_V15
//2048
//public key
static const uint8_t e1[] = {
   0x00, 0x00, 0x00, 0x00, 0x00, 0x00, 0x00, 0x00, 0x00, 0x00, 0x00, 0x00,
   0x00, 0x00, 0x00, 0x00, 0x00, 0x00, 0x00, 0x00, 0x00, 0x00, 0x00, 0x00,
   0x00, 0x00, 0x00, 0x00, 0x00, 0x00, 0x00, 0x00, 0x00, 0x00, 0x00, 0x00,
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   0x00, 0x01, 0x00, 0x01
};
static unsigned int e1_len = 256;

//private key
static const uint8_t d1[] = {
   0x02, 0x7a, 0xf5, 0x95, 0x77, 0x81, 0x4d, 0xe4, 0x6c, 0x21, 0xf3, 0x5e,
   0xbe, 0x82, 0xcf, 0x30, 0xce, 0x41, 0xcd, 0x39, 0xdb, 0xd1, 0xc7, 0x77,
   0xdd, 0x17, 0x8b, 0x5d, 0x39, 0x0e, 0x15, 0x98, 0x18, 0x99, 0x44, 0xa2,
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   0xdb, 0x70, 0x30, 0xb5
};
static unsigned int d1_len = 256;

//modulus
static const uint8_t n1[] = {
   0xcf, 0x01, 0xbb, 0x83, 0x7e, 0x2c, 0x4d, 0xd3, 0xd5, 0x6a, 0x09, 0x31,
   0x1b, 0x7b, 0xde, 0x4b, 0x9e, 0x11, 0x99, 0x5b, 0xde, 0x4d, 0x85, 0x77,
   0x6b, 0xcc, 0x50, 0x1f, 0x6f, 0x06, 0x7c, 0xc2, 0x0a, 0x0f, 0xe3, 0x4b,
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   0x66, 0x0e, 0xa9, 0x69
};
static unsigned int n1_len = 256;

//Message
static uint8_t Msg1[] = {
   0xa7, 0xc3, 0x09, 0xd4, 0x4a, 0x57, 0x18, 0x8b, 0xbd, 0x7b, 0x72, 0x6b,
   0x98, 0xb9, 0x8c, 0xe1, 0x25, 0x82, 0x22, 0x8e, 0x14, 0x15, 0x86, 0x48,
   0x70, 0xa2, 0x39, 0x61, 0xd2, 0xaf, 0xb8, 0x2c, 0xd5, 0xbc, 0x98, 0xbe,
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   0x44, 0xff, 0x9c, 0xcc, 0xd9, 0xcb, 0xd6, 0x7f
};
static unsigned int Msg1_len = 128;

uint8_t rng[] = {
   0x00, 0x01, 0x02, 0x03, 0x04, 0x05, 0x06, 0x07, 0x08, 0x09, 0x0a, 0x0b, 0x0c, 0x0d, 0x0e, 0x0f,
   0x00, 0x01, 0x02, 0x03, 0x04, 0x05, 0x06, 0x07, 0x08, 0x09, 0x0a, 0x0b, 0x0c, 0x0d, 0x0e, 0x0f,
   0x00, 0x01, 0x02, 0x03, 0x04, 0x05, 0x06, 0x07, 0x08, 0x09, 0x0a, 0x0b, 0x0c, 0x0d, 0x0e, 0x0f,
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   0x00, 0x01, 0x02, 0x03, 0x04, 0x05, 0x06, 0x07, 0x08, 0x09, 0x0a, 0x0b, 0x0c, 0x0d, 0x0e, 0x0f,
};
uint16_t rng_len = 144;

/* simulates the encrypted of a message followed by a decryption.
   - Uses a public key for the encryption.
   - Uses a private key for the decryption.
   - Verifies the message decrypted message.
*/
int rsa_encrypt_decrypt_main(void)
{
   struct pka_state pka;
   struct pka_rsa_mod rsamod;
   struct pka_rsa_key key;
   uint8_t  *mem_block;
   uint8_t *ct;
   uint8_t *msg_decrypted;
   int i = 0;
   uint16_t  keysize;

   int err = PKA_ERR;
   int fail_count = 1;

   printf("Start encrypt decrypt Sample App\n");

   // Init pka instance
   memset(&pka, 0, sizeof(struct pka_state));

   keysize = n1_len ;

   // malloc  a block of memory with the size of all buffer needed
   err = (int)ALLOC_MEMBLOCK( mem_block , MEM_BLOCK_SIZE(keysize));
   if (err == 0)
   {
       printf("%s line %d malloc fail size=0x%x\n", __FUNCTION__, __LINE__, MEM_BLOCK_SIZE(keysize));
       free(mem_block);
       return PKA_ERR;
   }
   memset(mem_block, 0, MEM_BLOCK_SIZE(keysize));

   // point buffers to memory block
   RSA_MOD_M(mem_block,rsamod.m, keysize);
   RSA_MOD_RSQR(mem_block,rsamod.r_sqr, keysize);
   RSA_MOD_MP(mem_block,rsamod.mp, keysize);
   RSA_KEY_EXP(mem_block, key.exp, keysize);
   RSA_CT(mem_block,ct, keysize);
   RSA_MSGDECRYPT(mem_block,msg_decrypted, keysize);

   //Initialize and load firmware
   err = pka_lib_setup(&pka, PKA_BASE_ADDRESS, (uint8_t *)ram_fw_bin, ram_fw_bin_len);
   if (err != PKA_OK)
   {
      printf("%s line=%d err=%d\n", __FUNCTION__, __LINE__, err);
      goto DONE;
   }

   // Initialize public key
   key.mod_size = n1_len;
   key.n = rsamod;
   memcpy(key.exp, e1, n1_len);
   memcpy(rsamod.m, n1, n1_len);

   // precompute function to populate r_sqr and  mp
   err = pka_rsa_precomp(&pka, &rsamod, n1_len);
   if (err != PKA_OK)
   {
      printf("%s line=%d err=%d\n", __FUNCTION__, __LINE__, err);
      goto DONE;
   }

   err = pka_rsa_encrypt(&pka, &key, Msg1, Msg1_len, rng, rng_len, ct);
   if (err != PKA_OK)
   {
      printf("%s line=%d err=%d\n", __FUNCTION__, __LINE__, err);
      goto DONE;
   }

   // load private key for decrypt
   memcpy(key.exp, d1, n1_len );

   err = pka_rsa_decrypt(&pka, &key, RSA_KEY, ct, msg_decrypted, Msg1_len);
   if (err != PKA_OK)
   {
      printf("%s line=%d err=%d\n", __FUNCTION__, __LINE__, err);
      goto DONE;
   }

   // check message
   fail_count = 0;
   for (i=0; i < Msg1_len; i++)
   {
      if (Msg1[i] != msg_decrypted[i])
      {
         printf("FAIL i = 0x%x  Msg1 = 0x%x,  actual = 0x%x\n", i, Msg1[i], msg_decrypted[i]);
         fail_count++;
      }
   }
   if (fail_count == 0)
   {
      printf("Encryption/Decryption PASSED\n");
   }
   else
   {
      printf("Encryption/Decryption FAILED fail count=%d\n", fail_count);
   }

DONE:
   free(mem_block);

   err = pka_lib_close(&pka);
   if (err != PKA_OK)
   {
      printf("%s line=%d err=%d\n", __FUNCTION__, __LINE__, err);
      return err;
   }

   return ((err == PKA_OK) && (fail_count == 0)) ? 0 : 1;
}

#if 0
int main(int argc, char **argv)
{
   return rsa_encrypt_decrypt_main();
}
#endif

/**
 * \endcode
 *
 * @} End SampleApps
 */
