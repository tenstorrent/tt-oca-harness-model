/*
 * This Synopsys software and associated documentation (hereinafter the
 * "Software") is an unsupported proprietary work of Synopsys, Inc. unless
 * otherwise expressly agreed to in writing between Synopsys and you. The
 * Software IS NOT an item of Licensed Software or a Licensed Product under
 * any End User Software License Agreement or Agreement for Licensed Products
 * with Synopsys or any supplement thereto. Synopsys is a registered trademark
 * of Synopsys, Inc. Other names included in the SOFTWARE may be the
 * trademarks of their respective owners.
 *
 * The contents of this file are dual-licensed; you may select either version
 * 2 of the GNU General Public License ("GPL") or the BSD-3-Clause license
 * ("BSD-3-Clause"). The GPL is included in the COPYING file accompanying the
 * SOFTWARE. The BSD License is copied below.
 *
 * BSD-3-Clause License:
 * Copyright (c) 2018-2020, 2022 Synopsys, Inc. and/or its affiliates.
 * Redistribution and use in source and binary forms, with or without
 * modification, are permitted provided that the following conditions are met:
 *
 * 1. Redistributions of source code must retain the above copyright notice,
 *    this list of conditions, and the following disclaimer, without
 *    modification.
 *
 * 2. Redistributions in binary form must reproduce the above copyright
 *    notice, this list of conditions and the following disclaimer in the
 *    documentation and/or other materials provided with the distribution.
 *
 * 3. The names of the above-listed copyright holders may not be used to
 *    endorse or promote products derived from this software without specific
 *    prior written permission.
 *
 * THIS SOFTWARE IS PROVIDED BY THE COPYRIGHT HOLDERS AND CONTRIBUTORS "AS IS"
 * AND ANY EXPRESS OR IMPLIED WARRANTIES, INCLUDING, BUT NOT LIMITED TO, THE
 * IMPLIED WARRANTIES OF MERCHANTABILITY AND FITNESS FOR A PARTICULAR PURPOSE
 * ARE DISCLAIMED. IN NO EVENT SHALL THE COPYRIGHT HOLDER OR CONTRIBUTORS BE
 * LIABLE FOR ANY DIRECT, INDIRECT, INCIDENTAL, SPECIAL, EXEMPLARY, OR
 * CONSEQUENTIAL DAMAGES (INCLUDING, BUT NOT LIMITED TO, PROCUREMENT OF
 * SUBSTITUTE GOODS OR SERVICES; LOSS OF USE, DATA, OR PROFITS; OR BUSINESS
 * INTERRUPTION) HOWEVER CAUSED AND ON ANY THEORY OF LIABILITY, WHETHER IN
 * CONTRACT, STRICT LIABILITY, OR TORT (INCLUDING NEGLIGENCE OR OTHERWISE)
 * ARISING IN ANY WAY OUT OF THE USE OF THIS SOFTWARE, EVEN IF ADVISED OF THE
 * POSSIBILITY OF SUCH DAMAGE.
 */

/**
 * \addtogroup SampleApps
 * @{
 *
 * \defgroup rsa_sign_verify_nist  rsa_sign_verify_nist.c
 *
 *
 * \code
 */

#include <stdio.h>
#include <stdlib.h>
#include <inttypes.h>
#include <string.h>
#include <errno.h>

#include "pka.h"
#include "ram_fw.h"

#define PKA_BASE_ADDRESS 0

#define ALLOC_MEMBLOCK(mem_ptr, size)            (mem_ptr =  malloc(size))
#define RSA_MOD_M(mem_ptr, buf, key_size)        (buf =      mem_ptr + (key_size * 0))
#define RSA_MOD_RSQR(mem_ptr, buf, key_size)     (buf =      mem_ptr + (key_size * 1))
#define RSA_MOD_MP(mem_ptr, buf, key_size)       (buf =      mem_ptr + (key_size * 2))
#define RSA_KEY_EXP(mem_ptr, buf, key_size)      (buf =      mem_ptr + (key_size * 3))
#define RSA_SIG(mem_ptr, buf, key_size)          (buf =      mem_ptr + (key_size * 4))
#define RSA_HAS(mem_ptr, buf, key_size)          (buf =      mem_ptr + (key_size * 5))

#define MEM_BLOCK_SIZE(key_size)    ((key_size * 6))

// RSA_PKCS1_V15_V15
//2048
// NIST/Test Vectors/Publication/FIPS 186-4/186-3rsatestvectors/SigGen15_186-3.txt

//public key
static const uint8_t e1[] = {
  0x00, 0x00, 0x00, 0x00, 0x00, 0x00, 0x00, 0x00, 0x00, 0x00, 0x00, 0x00,
  0x00, 0x00, 0x00, 0x00, 0x00, 0x00, 0x00, 0x00, 0x00, 0x00, 0x00, 0x00,
  0x00, 0x00, 0x00, 0x00, 0x00, 0x00, 0x00, 0x00, 0x00, 0x00, 0x00, 0x00,
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  0x00, 0x26, 0x04, 0x45
};
static unsigned int e1_len = 256;

//private key
static const uint8_t d1[] = {
  0x09, 0x97, 0x63, 0x4c, 0x47, 0x7c, 0x1a, 0x03, 0x9d, 0x44, 0xc8, 0x10,
  0xb2, 0xaa, 0xa3, 0xc7, 0x86, 0x2b, 0x0b, 0x88, 0xd3, 0x70, 0x82, 0x72,
  0xe1, 0xe1, 0x5f, 0x66, 0xfc, 0x93, 0x89, 0x70, 0x9f, 0x8a, 0x11, 0xf3,
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  0x98, 0xa3, 0x4b, 0x0d
};
static unsigned int d1_len = 256;

//modulus
static const uint8_t n1[] = {
  0xce, 0xa8, 0x04, 0x75, 0x32, 0x4c, 0x1d, 0xc8, 0x34, 0x78, 0x27, 0x81,
  0x8d, 0xa5, 0x8b, 0xac, 0x06, 0x9d, 0x34, 0x19, 0xc6, 0x14, 0xa6, 0xea,
  0x1a, 0xc6, 0xa3, 0xb5, 0x10, 0xdc, 0xd7, 0x2c, 0xc5, 0x16, 0x95, 0x49,
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  0xfb, 0x7f, 0xb7, 0x8d
};
static unsigned int n1_len = 256;

//Message
static const uint8_t Msg1[] = {
  0xa7, 0xc3, 0x09, 0xd4, 0x4a, 0x57, 0x18, 0x8b, 0xbd, 0x7b, 0x72, 0x6b,
  0x98, 0xb9, 0x8c, 0xe1, 0x25, 0x82, 0x22, 0x8e, 0x14, 0x15, 0x86, 0x48,
  0x70, 0xa2, 0x39, 0x61, 0xd2, 0xaf, 0xb8, 0x2c, 0xd5, 0xbc, 0x98, 0xbe,
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  0x44, 0xff, 0x9c, 0xcc, 0xd9, 0xcb, 0xd6, 0x7f
};
static unsigned int Msg1_len = 128;

static const uint8_t sha1[] = {
  0x68, 0xe7, 0xe5, 0x13, 0x2d, 0x2d, 0x59, 0x85, 0xfc, 0x0c, 0x12, 0xf7,
  0x87, 0xed, 0x39, 0x33, 0xfa, 0x96, 0xbf, 0xc4, 0xdd, 0x0e, 0x5f, 0xef,
  0xd3, 0x33, 0x36, 0x83, 0x6d, 0x2e, 0xff, 0x85, 0xa6, 0x52, 0x27, 0x5e,
  0x1c, 0xfd, 0x10, 0xf2, 0x76, 0xe1, 0xc2, 0xf5, 0x1c, 0x6d, 0x9b, 0x13,
  0xa0, 0x63, 0x99, 0x40, 0x7b, 0xaf, 0x2b, 0x3d, 0x9b, 0xf4, 0x68, 0xee,
  0xf0, 0xd2, 0xc4, 0xd8
};
static unsigned int Sha1_len = 64;

//Signature
static const uint8_t Sig1[] = {
  0x14, 0x8a, 0xf6, 0x1e, 0xd5, 0xea, 0x8a, 0x87, 0xa0, 0x8b, 0x3f, 0x40,
  0x39, 0x29, 0xbf, 0x80, 0x31, 0xdb, 0x4f, 0xd3, 0x99, 0x9b, 0x64, 0x40,
  0x9b, 0xa4, 0x89, 0xf9, 0x7a, 0x3e, 0xe5, 0x20, 0x8e, 0xa4, 0x20, 0x2d,
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  0x55, 0xc1, 0x68, 0x0c
};
static unsigned int Sig1_len = 256;

/* simulates the sign and verify of a message.
   - Uses a private key for the creating the signature.
   - Uses a public key for verifying the signature.
*/
int rsa_sign_verify_nist_main(void)
{
   struct pka_state pka;
   struct pka_rsa_mod rsamod;
   struct pka_rsa_key key;

   int err = PKA_ERR;
   int pass_fail = 1;

   uint8_t  *mem_block;
   uint8_t  *signature;
   uint8_t  *hash;
   uint16_t  keysize;

   printf("Start sign verify nist Sample App\n");

   // Init pka instance
   memset(&pka, 0, sizeof(struct pka_state));

   keysize = n1_len ;

   // malloc  a block of memory with the size of all buffer needed
   err = (int)ALLOC_MEMBLOCK( mem_block , MEM_BLOCK_SIZE(keysize));
   if (err == 0)
   {
       printf("%s line %d malloc fail size=0x%x\n", __FUNCTION__, __LINE__, MEM_BLOCK_SIZE(keysize));
       free(mem_block);
       return  PKA_ERR;
   }
   memset(mem_block, 0, MEM_BLOCK_SIZE(keysize));

   // point buffers to memory block
   RSA_MOD_M(mem_block,rsamod.m, keysize);
   RSA_MOD_RSQR(mem_block,rsamod.r_sqr, keysize);
   RSA_MOD_MP(mem_block,rsamod.mp, keysize);
   RSA_KEY_EXP(mem_block, key.exp, keysize);
   RSA_SIG(mem_block,signature, keysize);
   RSA_HAS(mem_block,hash, keysize);

   //Initialize and load firmware
   err = pka_lib_setup(&pka, PKA_BASE_ADDRESS, (uint8_t *)ram_fw_bin, ram_fw_bin_len);
   if (err != PKA_OK)
   {
      printf("%s line=%d err=%d\n", __FUNCTION__, __LINE__, err);
      goto DONE;
   }

   // Initialize  private key
   key.mod_size = n1_len;
   key.n = rsamod;
   memcpy(key.exp, d1,n1_len);
   memcpy(rsamod.m,n1, n1_len);
   memcpy(hash, sha1, n1_len );

   // precompute function to populate r_sqr and  mp
   err = pka_rsa_precomp(&pka, &rsamod, n1_len);
   if (err != PKA_OK)
   {
      printf("%s line=%d err=%d\n", __FUNCTION__, __LINE__, err);
      goto DONE;
   }

   // sign sha1
   err = pka_rsa_sign(&pka, &key, RSA_KEY, hash, PKA_HASH_SHA512, signature);
   if (err != PKA_OK)
   {
      printf("%s line %d err=0x%x\n", __FUNCTION__, __LINE__, err);
      goto DONE;
   }

   //copy the public key to structure for verification
   memcpy(key.exp, e1, n1_len);

   // verify Signature
   err = pka_rsa_verify(&pka, &key, hash, PKA_HASH_SHA512, signature);

   if (err != PKA_OK)
   {
      printf("%s line=%d err=%d\n", __FUNCTION__, __LINE__, err);
   }
   else
   {
      printf("Sign and verify passed\n");
      pass_fail = 0;
   }

DONE:
   free(mem_block);

   err = pka_lib_close(&pka);
   if (err != PKA_OK)
   {
      printf("%s line=%d err=%d\n", __FUNCTION__, __LINE__, err);
      return err;
   }

   return pass_fail;
}

#if 0
int main(int argc, char **argv)
{
   return rsa_sign_verify_nist_main();
}
#endif

/**
 * \endcode
 *
 * @} End SampleApps
 */
